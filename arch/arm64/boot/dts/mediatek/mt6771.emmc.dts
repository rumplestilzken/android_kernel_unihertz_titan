/dts-v1/;

/ {
	model = "mt6771";
	compatible = "mediatek,mt6771";
	interrupt-parent = <0x01>;
	#address-cells = <0x02>;
	#size-cells = <0x02>;

	chosen {
		bootargs = "console=tty0 console=ttyS0,921600n1 vmalloc=496M slub_max_order=0 slub_debug=OFZPU androidboot.hardware=mt6771 firmware_class.path=/vendor/firmware loop.max_part=7";
		linux,phandle = <0x4e>;
		phandle = <0x4e>;
	};

	cpus {
		#address-cells = <0x01>;
		#size-cells = <0x00>;

		cpu@000 {
			device_type = "cpu";
			compatible = "arm,cortex-a53";
			reg = <0x00>;
			enable-method = "psci";
			clock-frequency = <0x8b799100>;
			cpu-idle-states = <0x02 0x03 0x04 0x05 0x06 0x07 0x08>;
			linux,phandle = <0x09>;
			phandle = <0x09>;
		};

		cpu@001 {
			device_type = "cpu";
			compatible = "arm,cortex-a53";
			reg = <0x01>;
			enable-method = "psci";
			clock-frequency = <0x8b799100>;
			cpu-idle-states = <0x02 0x03 0x04 0x05 0x06 0x07 0x08>;
			linux,phandle = <0x0a>;
			phandle = <0x0a>;
		};

		cpu@002 {
			device_type = "cpu";
			compatible = "arm,cortex-a53";
			reg = <0x02>;
			enable-method = "psci";
			clock-frequency = <0x8b799100>;
			cpu-idle-states = <0x02 0x03 0x04 0x05 0x06 0x07 0x08>;
			linux,phandle = <0x0b>;
			phandle = <0x0b>;
		};

		cpu@003 {
			device_type = "cpu";
			compatible = "arm,cortex-a53";
			reg = <0x03>;
			enable-method = "psci";
			clock-frequency = <0x8b799100>;
			cpu-idle-states = <0x02 0x03 0x04 0x05 0x06 0x07 0x08>;
			linux,phandle = <0x0c>;
			phandle = <0x0c>;
		};

		cpu@100 {
			device_type = "cpu";
			compatible = "arm,cortex-a73";
			reg = <0x100>;
			enable-method = "psci";
			clock-frequency = <0x8b799100>;
			cpu-idle-states = <0x02 0x03 0x04 0x05 0x06 0x07 0x08>;
			linux,phandle = <0x0d>;
			phandle = <0x0d>;
		};

		cpu@101 {
			device_type = "cpu";
			compatible = "arm,cortex-a73";
			reg = <0x101>;
			enable-method = "psci";
			clock-frequency = <0x8b799100>;
			cpu-idle-states = <0x02 0x03 0x04 0x05 0x06 0x07 0x08>;
			linux,phandle = <0x0e>;
			phandle = <0x0e>;
		};

		cpu@102 {
			device_type = "cpu";
			compatible = "arm,cortex-a73";
			reg = <0x102>;
			enable-method = "psci";
			clock-frequency = <0x8b799100>;
			cpu-idle-states = <0x02 0x03 0x04 0x05 0x06 0x07 0x08>;
			linux,phandle = <0x0f>;
			phandle = <0x0f>;
		};

		cpu@103 {
			device_type = "cpu";
			compatible = "arm,cortex-a73";
			reg = <0x103>;
			enable-method = "psci";
			clock-frequency = <0x8b799100>;
			cpu-idle-states = <0x02 0x03 0x04 0x05 0x06 0x07 0x08>;
			linux,phandle = <0x10>;
			phandle = <0x10>;
		};

		cpu-map {

			cluster0 {

				core0 {
					cpu = <0x09>;
				};

				core1 {
					cpu = <0x0a>;
				};

				core2 {
					cpu = <0x0b>;
				};

				core3 {
					cpu = <0x0c>;
				};
			};

			cluster1 {

				core0 {
					cpu = <0x0d>;
				};

				core1 {
					cpu = <0x0e>;
				};

				core2 {
					cpu = <0x0f>;
				};

				core3 {
					cpu = <0x10>;
				};
			};
		};

		idle-states {
			entry-method = "arm,psci";

			standby {
				compatible = "arm,idle-state";
				arm,psci-suspend-param = <0x01>;
				entry-latency-us = <0x258>;
				exit-latency-us = <0x258>;
				min-residency-us = <0x4b0>;
				linux,phandle = <0x02>;
				phandle = <0x02>;
			};

			mcdi-cpu {
				compatible = "arm,idle-state";
				arm,psci-suspend-param = <0x10001>;
				entry-latency-us = <0x258>;
				exit-latency-us = <0x258>;
				min-residency-us = <0x4b0>;
				linux,phandle = <0x03>;
				phandle = <0x03>;
			};

			mcdi-cluster {
				compatible = "arm,idle-state";
				arm,psci-suspend-param = <0x1010001>;
				entry-latency-us = <0x258>;
				exit-latency-us = <0x258>;
				min-residency-us = <0x4b0>;
				linux,phandle = <0x04>;
				phandle = <0x04>;
			};

			sodi {
				compatible = "arm,idle-state";
				arm,psci-suspend-param = <0x1010002>;
				entry-latency-us = <0x320>;
				exit-latency-us = <0x3e8>;
				min-residency-us = <0x7d0>;
				linux,phandle = <0x05>;
				phandle = <0x05>;
			};

			sodi3 {
				compatible = "arm,idle-state";
				arm,psci-suspend-param = <0x1010003>;
				entry-latency-us = <0x320>;
				exit-latency-us = <0x3e8>;
				min-residency-us = <0x7d0>;
				linux,phandle = <0x06>;
				phandle = <0x06>;
			};

			dpidle {
				compatible = "arm,idle-state";
				arm,psci-suspend-param = <0x1010004>;
				entry-latency-us = <0x320>;
				exit-latency-us = <0x3e8>;
				min-residency-us = <0x7d0>;
				linux,phandle = <0x07>;
				phandle = <0x07>;
			};

			suspend {
				compatible = "arm,idle-state";
				arm,psci-suspend-param = <0x1010005>;
				entry-latency-us = <0x320>;
				exit-latency-us = <0x3e8>;
				min-residency-us = <0x7d0>;
				linux,phandle = <0x08>;
				phandle = <0x08>;
			};
		};
	};

	psci {
		compatible = "arm,psci-1.0";
		method = "smc";
	};

	pmu {
		compatible = "arm,armv8-pmuv3";
		interrupt-parent = <0x11>;
		interrupts = <0x01 0x07 0x08>;
	};

	memory {
		device_type = "memory";
		reg = <0x00 0x40000000 0x00 0x1e605000>;
	};

	cpu_dbgapb@0d410000 {
		compatible = "mediatek,hw_dbg";
		num = <0x08>;
		reg = <0x00 0xd410000 0x00 0x1000 0x00 0xd510000 0x00 0x1000 0x00 0xd610000 0x00 0x1000 0x00 0xd710000 0x00 0x1000 0x00 0xd810000 0x00 0x1000 0x00 0xd910000 0x00 0x1000 0x00 0xda10000 0x00 0x1000 0x00 0xdb10000 0x00 0x1000>;
		linux,phandle = <0x4f>;
		phandle = <0x4f>;
	};

	atf_logger {
		compatible = "mediatek,atf_logger";
		interrupts = <0x00 0xf5 0x01>;
	};

	amms_control {
		compatible = "mediatek,amms";
		interrupts = <0x00 0x132 0x01>;
	};

	utos {
		compatible = "microtrust,utos";
		interrupts = <0x00 0x128 0x01 0x00 0x129 0x01>;
	};

	utos_tester {
		compatible = "microtrust,tester-v1";
	};

	msdc@11230000 {
		compatible = "mediatek,msdc";
		reg = <0x00 0x11230000 0x00 0x10000>;
		interrupts = <0x00 0x4d 0x08>;
		index = [00];
		clk_src = [01];
		bus-width = <0x08>;
		max-frequency = <0xbebc200>;
		cap-mmc-highspeed;
		msdc-sys-suspend;
		mmc-ddr-1_8v;
		mmc-hs200-1_8v;
		mmc-hs400-1_8v;
		non-removable;
		pinctl = <0x12>;
		register_setting = <0x13>;
		host_function = [00];
		bootable;
		status = "okay";
		vmmc-supply = <0x14>;
		clocks = <0x15 0x20 0x15 0x1d>;
		clock-names = "msdc0-clock\0msdc0-hclock";
		hw_dvfs = [00];
		linux,phandle = <0x39>;
		phandle = <0x39>;
	};

	msdc@11240000 {
		compatible = "mediatek,msdc";
		reg = <0x00 0x11240000 0x00 0x10000>;
		interrupts = <0x00 0x4e 0x08>;
		index = [01];
		clk_src = [04];
		bus-width = <0x04>;
		max-frequency = <0xbebc200>;
		msdc-sys-suspend;
		cap-sd-highspeed;
		sd-vmch-fastoff;
		sd-uhs-sdr12;
		sd-uhs-sdr25;
		sd-uhs-sdr50;
		sd-uhs-sdr104;
		sd-uhs-ddr50;
		pinctl = <0x16>;
		pinctl_sdr104 = <0x17>;
		pinctl_sdr50 = <0x18>;
		pinctl_ddr50 = <0x19>;
		register_setting = <0x1a>;
		host_function = [01];
		cd_level = [01];
		cd-gpios = <0x1b 0x03 0x00>;
		status = "okay";
		vmmc-supply = <0x1c>;
		vqmmc-supply = <0x1d>;
		clocks = <0x15 0x29 0x15 0x1e>;
		clock-names = "msdc1-clock\0msdc1-hclock";
		hw_dvfs = [00];
		linux,phandle = <0x50>;
		phandle = <0x50>;
	};

	msdc0_top@11f50000 {
		compatible = "mediatek,msdc0_top";
		reg = <0x00 0x11f50000 0x00 0x1000>;
	};

	msdc1_top@11e10000 {
		compatible = "mediatek,msdc1_top";
		reg = <0x00 0x11e10000 0x00 0x1000>;
	};

	reserved-memory {
		#address-cells = <0x02>;
		#size-cells = <0x02>;
		ranges;
		linux,phandle = <0x51>;
		phandle = <0x51>;

		pstore-reserved-memory@54410000 {
			compatible = "mediatek,pstore";
			reg = <0x00 0x54410000 0x00 0xe0000>;
		};

		ram_console-reserved-memory@54400000 {
			compatible = "mediatek,ram_console";
			reg = <0x00 0x54400000 0x00 0x10000>;
		};

		minirdump-reserved-memory@544f0000 {
			compatible = "mediatek,minirdump";
			reg = <0x00 0x544f0000 0x00 0x10000>;
		};

		reserve-memory-sspm_share {
			compatible = "mediatek,reserve-memory-sspm_share";
			no-map;
			status = "okay";
			size = <0x00 0x510000>;
			alignment = <0x00 0x10000>;
			alloc-ranges = <0x00 0x40000000 0x00 0x60000000>;
		};

		reserve-memory-scp_share {
			compatible = "mediatek,reserve-memory-scp_share";
			no-map;
			size = <0x00 0x1400000>;
			alignment = <0x00 0x1000000>;
			alloc-ranges = <0x00 0x40000000 0x00 0x50000000>;
		};

		consys-reserve-memory {
			compatible = "mediatek,consys-reserve-memory";
			no-map;
			size = <0x00 0x200000>;
			alignment = <0x00 0x200000>;
			alloc-ranges = <0x00 0x40000000 0x00 0x80000000>;
		};
	};

	interrupt-controller@0c000000 {
		compatible = "arm,gic-v3";
		#interrupt-cells = <0x03>;
		#address-cells = <0x02>;
		#size-cells = <0x02>;
		#redistributor-regions = <0x01>;
		interrupt-parent = <0x11>;
		interrupt-controller;
		reg = <0x00 0xc000000 0x00 0x40000 0x00 0xc100000 0x00 0x200000 0x00 0xc530a80 0x00 0x50>;
		interrupts = <0x01 0x09 0x04>;
		linux,phandle = <0x11>;
		phandle = <0x11>;
	};

	intpol-controller@0c530620 {
		compatible = "mediatek,mt6771-sysirq\0mediatek,mt6577-sysirq";
		interrupt-controller;
		#interrupt-cells = <0x03>;
		interrupt-parent = <0x11>;
		reg = <0x00 0xc530a80 0x00 0x50>;
		linux,phandle = <0x01>;
		phandle = <0x01>;
	};

	mobicore {
		compatible = "trustonic,mobicore";
		interrupts = <0x00 0x130 0x01>;
	};

	tkcore {
		compatible = "trustkernel,tkcore";
		interrupts = <0x00 0x6f 0x01>;
	};

	chipid@08000000 {
		compatible = "mediatek,chipid";
		reg = <0x00 0x8000000 0x00 0x04 0x00 0x8000004 0x00 0x04 0x00 0x8000008 0x00 0x04 0x00 0x800000c 0x00 0x04>;
	};

	timer {
		compatible = "arm,armv8-timer";
		interrupt-parent = <0x11>;
		interrupts = <0x01 0x0d 0x08 0x01 0x0e 0x08 0x01 0x0b 0x08 0x01 0x0a 0x08>;
		clock-frequency = <0xc65d40>;
		linux,phandle = <0x52>;
		phandle = <0x52>;
	};

	clocks {

		clk_null {
			compatible = "fixed-clock";
			#clock-cells = <0x00>;
			clock-frequency = <0x00>;
			linux,phandle = <0x53>;
			phandle = <0x53>;
		};

		clk26m {
			compatible = "fixed-clock";
			#clock-cells = <0x00>;
			clock-frequency = <0x18cba80>;
			linux,phandle = <0x3d>;
			phandle = <0x3d>;
		};

		clk32k {
			compatible = "fixed-clock";
			#clock-cells = <0x00>;
			clock-frequency = <0x7d00>;
			linux,phandle = <0x2a>;
			phandle = <0x2a>;
		};
	};

	topckgen@10000000 {
		compatible = "mediatek,topckgen\0syscon";
		reg = <0x00 0x10000000 0x00 0x1000>;
		#clock-cells = <0x01>;
		linux,phandle = <0x3f>;
		phandle = <0x3f>;
	};

	infracfg_ao@10001000 {
		compatible = "mediatek,infracfg_ao\0syscon";
		reg = <0x00 0x10001000 0x00 0x1000>;
		interrupts = <0x00 0x96 0x01>;
		#clock-cells = <0x01>;
		linux,phandle = <0x15>;
		phandle = <0x15>;
	};

	scpsys@10001000 {
		compatible = "mediatek,scpsys";
		reg = <0x00 0x10001000 0x00 0x1000 0x00 0x10006000 0x00 0x1000 0x00 0x1020e000 0x00 0x1000 0x00 0x10000000 0x00 0x1000 0x00 0x1a001000 0x00 0x1000 0x00 0x14019000 0x00 0x1000>;
		#clock-cells = <0x01>;
		linux,phandle = <0x2b>;
		phandle = <0x2b>;
	};

	iocfg_0@10002000 {
		compatible = "mediatek,iocfg_0";
		reg = <0x00 0x10002000 0x00 0x1000>;
	};

	iocfg_1@10002200 {
		compatible = "mediatek,iocfg_1";
		reg = <0x00 0x10002200 0x00 0x1000>;
	};

	iocfg_2@10002400 {
		compatible = "mediatek,iocfg_2";
		reg = <0x00 0x10002400 0x00 0x1000>;
	};

	iocfg_3@10002600 {
		compatible = "mediatek,iocfg_3";
		reg = <0x00 0x10002600 0x00 0x1000>;
	};

	iocfg_4@10002800 {
		compatible = "mediatek,iocfg_4";
		reg = <0x00 0x10002800 0x00 0x1000>;
	};

	iocfg_5@10002a00 {
		compatible = "mediatek,iocfg_5";
		reg = <0x00 0x10002a00 0x00 0x1000>;
	};

	iocfg_6@10002c00 {
		compatible = "mediatek,iocfg_6";
		reg = <0x00 0x10002c00 0x00 0x1000>;
	};

	pericfg@10003000 {
		compatible = "mediatek,pericfg";
		reg = <0x00 0x10003000 0x00 0x1000>;
	};

	gpio {
		compatible = "mediatek,gpio_usage_mapping";
		linux,phandle = <0x54>;
		phandle = <0x54>;
	};

	gpio@10005000 {
		compatible = "mediatek,gpio";
		reg = <0x00 0x10005000 0x00 0x1000>;
		linux,phandle = <0x55>;
		phandle = <0x55>;
	};

	syscfg_pctl_a@10005000 {
		compatible = "mediatek,pctl-a-syscfg\0syscon";
		reg = <0x00 0x10005000 0x00 0x1000>;
		linux,phandle = <0x1e>;
		phandle = <0x1e>;
	};

	syscfg_pctl_0@11f20000 {
		compatible = "mediatek,pctl-0-syscfg\0syscon";
		reg = <0x00 0x11f20000 0x00 0x1000>;
		linux,phandle = <0x1f>;
		phandle = <0x1f>;
	};

	syscfg_pctl_1@11e80000 {
		compatible = "mediatek,pctl-1-syscfg\0syscon";
		reg = <0x00 0x11e80000 0x00 0x1000>;
		linux,phandle = <0x20>;
		phandle = <0x20>;
	};

	syscfg_pctl_2@11e70000 {
		compatible = "mediatek,pctl-2-syscfg\0syscon";
		reg = <0x00 0x11e70000 0x00 0x1000>;
		linux,phandle = <0x21>;
		phandle = <0x21>;
	};

	syscfg_pctl_3@11e90000 {
		compatible = "mediatek,pctl-3-syscfg\0syscon";
		reg = <0x00 0x11e90000 0x00 0x1000>;
		linux,phandle = <0x22>;
		phandle = <0x22>;
	};

	syscfg_pctl_4@11d30000 {
		compatible = "mediatek,pctl-4-syscfg\0syscon";
		reg = <0x00 0x11d30000 0x00 0x1000>;
		linux,phandle = <0x23>;
		phandle = <0x23>;
	};

	syscfg_pctl_5@11d20000 {
		compatible = "mediatek,pctl-5-syscfg\0syscon";
		reg = <0x00 0x11d20000 0x00 0x1000>;
		linux,phandle = <0x24>;
		phandle = <0x24>;
	};

	syscfg_pctl_6@11c50000 {
		compatible = "mediatek,pctl-6-syscfg\0syscon";
		reg = <0x00 0x11c50000 0x00 0x1000>;
		linux,phandle = <0x25>;
		phandle = <0x25>;
	};

	syscfg_pctl_7@11f30000 {
		compatible = "mediatek,pctl-7-syscfg\0syscon";
		reg = <0x00 0x11f30000 0x00 0x1000>;
		linux,phandle = <0x26>;
		phandle = <0x26>;
	};

	pinctrl@1000b000 {
		compatible = "mediatek,pinctrl";
		reg = <0x00 0x1000b000 0x00 0x1000>;
		mediatek,pctl-regmap = <0x1e 0x1f 0x20 0x21 0x22 0x23 0x24 0x25 0x26>;
		pins-are-numbered;
		gpio-controller;
		#gpio-cells = <0x02>;
		interrupt-controller;
		#interrupt-cells = <0x04>;
		interrupts = <0x00 0xb1 0x04>;
		linux,phandle = <0x1b>;
		phandle = <0x1b>;

		msdc0@default {
			linux,phandle = <0x12>;
			phandle = <0x12>;

			pins_cmd {
				drive-strength = [04];
			};

			pins_dat {
				drive-strength = [04];
			};

			pins_clk {
				drive-strength = [04];
			};

			pins_rst {
				drive-strength = [04];
			};

			pins_ds {
				drive-strength = [04];
			};
		};

		msdc0@register_default {
			cmd_edge = [00];
			rdata_edge = [00];
			wdata_edge = [00];
			linux,phandle = <0x13>;
			phandle = <0x13>;
		};

		msdc1@default {
			linux,phandle = <0x16>;
			phandle = <0x16>;

			pins_cmd {
				drive-strength = [03];
			};

			pins_dat {
				drive-strength = [03];
			};

			pins_clk {
				drive-strength = [03];
			};
		};

		msdc1@sdr104 {
			linux,phandle = <0x17>;
			phandle = <0x17>;

			pins_cmd {
				drive-strength = [03];
			};

			pins_dat {
				drive-strength = [03];
			};

			pins_clk {
				drive-strength = [03];
			};
		};

		msdc1@sdr50 {
			linux,phandle = <0x18>;
			phandle = <0x18>;

			pins_cmd {
				drive-strength = [03];
			};

			pins_dat {
				drive-strength = [03];
			};

			pins_clk {
				drive-strength = [03];
			};
		};

		msdc1@ddr50 {
			linux,phandle = <0x19>;
			phandle = <0x19>;

			pins_cmd {
				drive-strength = [03];
			};

			pins_dat {
				drive-strength = [03];
			};

			pins_clk {
				drive-strength = [03];
			};
		};

		msdc1@register_default {
			cmd_edge = [00];
			rdata_edge = [00];
			wdata_edge = [00];
			linux,phandle = <0x1a>;
			phandle = <0x1a>;
		};
	};

	i2c@11007000 {
		compatible = "mediatek,mt6771-i2c";
		id = <0x00>;
		reg = <0x00 0x11007000 0x00 0x1000 0x00 0x11000080 0x00 0x80>;
		interrupts = <0x00 0x51 0x08>;
		clocks = <0x15 0x0b 0x15 0x2b>;
		clock-names = "main\0dma";
		clock-div = <0x05>;
		mediatek,hs_only;
		mediatek,skip_scp_sema;
		linux,phandle = <0x56>;
		phandle = <0x56>;
	};

	i2c@11011000 {
		compatible = "mediatek,mt6771-i2c";
		id = <0x01>;
		reg = <0x00 0x11011000 0x00 0x1000 0x00 0x11000480 0x00 0x80>;
		interrupts = <0x00 0x55 0x08>;
		clocks = <0x15 0x3a 0x15 0x2b>;
		clock-names = "main\0dma";
		clock-div = <0x05>;
		mediatek,hs_only;
		mediatek,skip_scp_sema;
		linux,phandle = <0x57>;
		phandle = <0x57>;
	};

	i2c@11009000 {
		compatible = "mediatek,mt6771-i2c";
		id = <0x02>;
		reg = <0x00 0x11009000 0x00 0x1000 0x00 0x11000280 0x00 0x80>;
		interrupts = <0x00 0x53 0x08>;
		clocks = <0x15 0x0d 0x15 0x2b 0x15 0x4a>;
		clock-names = "main\0dma\0arb";
		clock-div = <0x05>;
		ch_offset_default = <0x100>;
		ccu-ch-offset = <0x200>;
		mediatek,hs_only;
		linux,phandle = <0x58>;
		phandle = <0x58>;
	};

	i2c@1100f000 {
		compatible = "mediatek,mt6771-i2c";
		id = <0x03>;
		reg = <0x00 0x1100f000 0x00 0x1000 0x00 0x11000400 0x00 0x80>;
		interrupts = <0x00 0x54 0x08>;
		clocks = <0x15 0x0e 0x15 0x2b>;
		clock-names = "main\0dma";
		clock-div = <0x05>;
		mediatek,hs_only;
		linux,phandle = <0x59>;
		phandle = <0x59>;
	};

	i2c@11008000 {
		compatible = "mediatek,mt6771-i2c";
		id = <0x04>;
		reg = <0x00 0x11008000 0x00 0x1000 0x00 0x11000100 0x00 0x80>;
		interrupts = <0x00 0x52 0x08>;
		clocks = <0x15 0x0c 0x15 0x2b 0x15 0x48>;
		clock-names = "main\0dma\0arb";
		clock-div = <0x05>;
		ch_offset_default = <0x100>;
		ccu-ch-offset = <0x200>;
		mediatek,hs_only;
		linux,phandle = <0x5a>;
		phandle = <0x5a>;
	};

	i2c@11017000 {
		compatible = "mediatek,mt6771-i2c";
		id = <0x05>;
		reg = <0x00 0x11017000 0x00 0x1000 0x00 0x11000580 0x00 0x80>;
		interrupts = <0x00 0x85 0x08>;
		clocks = <0x15 0x47 0x15 0x2b 0x15 0x46>;
		clock-names = "main\0dma\0arb";
		clock-div = <0x05>;
		mediatek,hs_only;
		linux,phandle = <0x5b>;
		phandle = <0x5b>;
	};

	i2c@11005000 {
		compatible = "mediatek,mt6771-i2c";
		id = <0x06>;
		reg = <0x00 0x11005000 0x00 0x1000 0x00 0x11000600 0x00 0x80>;
		interrupts = <0x00 0x57 0x08>;
		clocks = <0x15 0x58 0x15 0x2b>;
		clock-names = "main\0dma";
		clock-div = <0x05>;
		mediatek,hs_only;
		linux,phandle = <0x5c>;
		phandle = <0x5c>;
	};

	i2c@1101a000 {
		compatible = "mediatek,mt6771-i2c";
		id = <0x07>;
		reg = <0x00 0x1101a000 0x00 0x1000 0x00 0x11000680 0x00 0x80>;
		interrupts = <0x00 0x58 0x08>;
		clocks = <0x15 0x63 0x15 0x2b>;
		clock-names = "main\0dma";
		clock-div = <0x05>;
		mediatek,hs_only;
		linux,phandle = <0x5d>;
		phandle = <0x5d>;
	};

	i2c@1101b000 {
		compatible = "mediatek,mt6771-i2c";
		id = <0x08>;
		reg = <0x00 0x1101b000 0x00 0x1000 0x00 0x11000700 0x00 0x80>;
		interrupts = <0x00 0x59 0x08>;
		clocks = <0x15 0x64 0x15 0x2b>;
		clock-names = "main\0dma";
		clock-div = <0x05>;
		mediatek,hs_only;
		linux,phandle = <0x5e>;
		phandle = <0x5e>;
	};

	i2c@11014000 {
		compatible = "mediatek,mt6771-i2c";
		id = <0x09>;
		reg = <0x00 0x11014000 0x00 0x1000 0x00 0x11000180 0x00 0x80>;
		interrupts = <0x00 0x83 0x08>;
		clocks = <0x15 0x49 0x15 0x2b 0x15 0x48>;
		clock-names = "main\0dma\0arb";
		clock-div = <0x05>;
		mediatek,hs_only;
		linux,phandle = <0x5f>;
		phandle = <0x5f>;
	};

	i2c@11015000 {
		compatible = "mediatek,mt6771-i2c";
		id = <0x0a>;
		reg = <0x00 0x11015000 0x00 0x1000 0x00 0x11000300 0x00 0x80>;
		interrupts = <0x00 0x84 0x08>;
		clocks = <0x15 0x4b 0x15 0x2b 0x15 0x4a>;
		clock-names = "main\0dma\0arb";
		clock-div = <0x05>;
		mediatek,hs_only;
		linux,phandle = <0x60>;
		phandle = <0x60>;
	};

	i2c@11016000 {
		compatible = "mediatek,mt6771-i2c";
		id = <0x0b>;
		reg = <0x00 0x11016000 0x00 0x1000 0x00 0x11000500 0x00 0x80>;
		interrupts = <0x00 0x56 0x08>;
		clocks = <0x15 0x45 0x15 0x2b 0x15 0x46>;
		clock-names = "main\0dma\0arb";
		clock-div = <0x05>;
		mediatek,hs_only;
		linux,phandle = <0x61>;
		phandle = <0x61>;
	};

	sspm@10440000 {
		compatible = "mediatek,sspm";
		reg = <0x00 0x10440000 0x00 0x10000 0x00 0x10450000 0x00 0x100 0x00 0x10451000 0x00 0x08 0x00 0x10460000 0x00 0x100 0x00 0x10461000 0x00 0x08 0x00 0x10470000 0x00 0x100 0x00 0x10471000 0x00 0x08 0x00 0x10480000 0x00 0x100 0x00 0x10481000 0x00 0x08 0x00 0x10490000 0x00 0x100 0x00 0x10491000 0x00 0x08>;
		reg-names = "cfgreg\0mbox0_base\0mbox0_ctrl\0mbox1_base\0mbox1_ctrl\0mbox2_base\0mbox2_ctrl\0mbox3_base\0mbox3_ctrl\0mbox4_base\0mbox4_ctrl";
		interrupts = <0x00 0xd0 0x04 0x00 0xd3 0x04 0x00 0xd4 0x04 0x00 0xd5 0x04 0x00 0xd6 0x04 0x00 0xd7 0x04>;
		interrupt-names = "ipc\0mbox0\0mbox1\0mbox2\0mbox3\0mbox4";
	};

	sleep@10006000 {
		compatible = "mediatek,sleep";
		reg = <0x00 0x10006000 0x00 0x1000>;
		interrupts = <0x00 0xbb 0x08>;
		wakeup-source = <0x27 0x00 0x04 0x28 0x01 0x20 0x29 0x03 0x2000000>;
	};

	toprgu@10007000 {
		compatible = "mediatek,toprgu";
		reg = <0x00 0x10007000 0x00 0x1000>;
		interrupts = <0x00 0x8e 0x00>;
	};

	apxgpt@10008000 {
		compatible = "mediatek,apxgpt";
		reg = <0x00 0x10008000 0x00 0x100>;
		interrupts = <0x00 0xb0 0x08>;
		clocks = <0x2a>;
	};

	rsvd@10009000 {
		compatible = "mediatek,rsvd";
		reg = <0x00 0x10009000 0x00 0x1000>;
	};

	hacc@1000a000 {
		compatible = "mediatek,hacc";
		reg = <0x00 0x1000a000 0x00 0x1000>;
		interrupts = <0x00 0xc3 0x08>;
	};

	apirq@1000b000 {
		compatible = "mediatek,apirq";
		reg = <0x00 0x1000b000 0x00 0x1000>;
		interrupts = <0x00 0xb1 0x04>;
	};

	apmixed@1000c000 {
		compatible = "mediatek,apmixed\0syscon";
		reg = <0x00 0x1000c000 0x00 0x1000>;
		#clock-cells = <0x01>;
		linux,phandle = <0x62>;
		phandle = <0x62>;
	};

	fhctl@1000ce00 {
		compatible = "mediatek,fhctl";
		reg = <0x00 0x1000ce00 0x00 0x1000>;
	};

	pwrap@1000d000 {
		compatible = "mediatek,pwrap";
		reg = <0x00 0x1000d000 0x00 0x1000>;
		interrupts = <0x00 0xb9 0x04>;

		pmic_irq {
			compatible = "mediatek,pmic-eint";
			interrupt-controller;
			linux,phandle = <0x63>;
			phandle = <0x63>;
		};
	};

	pwrap_mpu@1000d000 {
		compatible = "mediatek,pwrap_mpu";
		reg = <0x00 0x1000d000 0x00 0x1000>;
	};

	pwrap_p2p@1005e000 {
		compatible = "mediatek,pwrap_p2p";
		reg = <0x00 0x105cb000 0x00 0x1000>;
	};

	pwrap_md32@10448000 {
		compatible = "mediatek,pwrap_md32";
		reg = <0x00 0x10448000 0x00 0x1000>;
	};

	sleep_reg_md@1000f000 {
		compatible = "mediatek,sleep_reg_md";
		reg = <0x00 0x1000f000 0x00 0x1000>;
	};

	kp@10010000 {
		compatible = "mediatek,kp";
		reg = <0x00 0x10010000 0x00 0x1000>;
		interrupts = <0x00 0xba 0x02>;
		linux,phandle = <0x27>;
		phandle = <0x27>;
	};

	mrdump_ext_rst {
		compatible = "mediatek, mrdump_ext_rst-eint";
		source = "EINT";
		mode = "IRQ";
		status = "okay";
		linux,phandle = <0x64>;
		phandle = <0x64>;
	};

	topmisc@10011000 {
		compatible = "mediatek,topmisc";
		reg = <0x00 0x10011000 0x00 0x1000>;
	};

	dvfsrc_top@10012000 {
		compatible = "mediatek,dvfsrc_top";
		reg = <0x00 0x10012000 0x00 0x1000 0x00 0x11bb80 0x00 0x80>;
	};

	apcldmain_ao@10014000 {
		compatible = "mediatek,apcldmain_ao";
		reg = <0x00 0x10014000 0x00 0x1000>;
	};

	apcldmaout_ao@10014400 {
		compatible = "mediatek,apcldmaout_ao";
		reg = <0x00 0x10014400 0x00 0x1000>;
	};

	apcldmamisc_ao@10014800 {
		compatible = "mediatek,apcldmamisc_ao";
		reg = <0x00 0x10014800 0x00 0x1000>;
	};

	devapc_mpu_ao@10015000 {
		compatible = "mediatek,devapc_mpu_ao";
		reg = <0x00 0x10015000 0x00 0x1000>;
	};

	aes_top0@10016000 {
		compatible = "mediatek,aes_top0";
		reg = <0x00 0x10016000 0x00 0x1000>;
	};

	sys_timer@10017000 {
		compatible = "mediatek,sys_timer";
		reg = <0x00 0x10017000 0x00 0x1000>;
		reg-names = "sys_timer_base";
		interrupts = <0x00 0xca 0x04>;
	};

	modem_temp_share@10018000 {
		compatible = "mediatek,modem_temp_share";
		reg = <0x00 0x10018000 0x00 0x1000>;
	};

	mbist_ao@10013000 {
		compatible = "mediatek,mbist_ao";
		reg = <0x00 0x10013000 0x00 0x1000>;
	};

	security_ao@1001a000 {
		compatible = "mediatek,security_ao";
		reg = <0x00 0x1001a000 0x00 0x1000>;
	};

	topckgen_ao@1001b000 {
		compatible = "mediatek,topckgen_ao";
		reg = <0x00 0x1001b000 0x00 0x1000>;
	};

	scp@10500000 {
		compatible = "mediatek,scp";
		status = "okay";
		reg = <0x00 0x10500000 0x00 0x80000 0x00 0x105c0000 0x00 0x3000 0x00 0x105c4000 0x00 0x1000 0x00 0x105d4000 0x00 0x6000>;
		interrupts = <0x00 0xae 0x04>;
		linux,phandle = <0x65>;
		phandle = <0x65>;
	};

	scp_cfgreg@105c0000 {
		compatible = "mediatek,scp_cfgreg";
		reg = <0x00 0x105c0000 0x00 0x1000>;
	};

	scp_mad@105c1000 {
		compatible = "mediatek,scp_mad";
		reg = <0x00 0x105c1000 0x00 0x1000>;
	};

	scp_intc@105c2000 {
		compatible = "mediatek,scp_intc";
		reg = <0x00 0x105c2000 0x00 0x1000>;
	};

	scp_timer@105c3000 {
		compatible = "mediatek,scp_timer";
		reg = <0x00 0x105c3000 0x00 0x1000>;
	};

	scp_clk_ctrl@105c4000 {
		compatible = "mediatek,scp_clk_ctrl";
		reg = <0x00 0x105c4000 0x00 0x1000>;
	};

	scp_i2c0@105c5000 {
		compatible = "mediatek,scp_i2c0";
		reg = <0x00 0x105c5000 0x00 0x1000>;
	};

	scp_i2c1@105c6000 {
		compatible = "mediatek,scp_i2c1";
		reg = <0x00 0x105c6000 0x00 0x1000>;
	};

	scp_i2c2@105c7000 {
		compatible = "mediatek,scp_i2c2";
		reg = <0x00 0x105c7000 0x00 0x1000>;
	};

	scp_gpio@105c8000 {
		compatible = "mediatek,scp_gpio";
		reg = <0x00 0x105c8000 0x00 0x1000>;
	};

	scp_uart@105c9000 {
		compatible = "mediatek,scp_uart";
		reg = <0x00 0x105c9000 0x00 0x1000>;
	};

	scp_cirq_eint@105ca000 {
		compatible = "mediatek,scp_cirq_eint";
		reg = <0x00 0x105ca000 0x00 0x1000>;
	};

	scp_dma@105cd000 {
		compatible = "mediatek,scp_dma";
		reg = <0x00 0x105cd000 0x00 0x1000>;
	};

	scp_uart1@105ce000 {
		compatible = "mediatek,scp_uart1";
		reg = <0x00 0x105ce000 0x00 0x1000>;
	};

	scp_spi0@105cf000 {
		compatible = "mediatek,scp_spi0";
		reg = <0x00 0x105cf000 0x00 0x1000>;
	};

	scp_spi1@105d0000 {
		compatible = "mediatek,scp_spi1";
		reg = <0x00 0x105d0000 0x00 0x1000>;
	};

	scp_spi2@105d1000 {
		compatible = "mediatek,scp_spi2";
		reg = <0x00 0x105d1000 0x00 0x1000>;
	};

	dbgapb@0d000000 {
		compatible = "mediatek,dbgapb";
		reg = <0x00 0xd000000 0x00 0x1000>;
	};

	mcucfg@0c530000 {
		compatible = "mediatek,mcucfg";
		reg = <0x00 0xc530000 0x00 0x1000>;
		interrupts = <0x00 0x00 0x08>;
	};

	mp0_cpucfg@0c530000 {
		compatible = "mediatek,mp0_cpucfg";
		reg = <0x00 0xc530000 0x00 0x1000>;
	};

	mp1_cpucfg@0c530200 {
		compatible = "mediatek,mp1_cpucfg";
		reg = <0x00 0xc530200 0x00 0x1000>;
	};

	mcu_misccfg@0c530400 {
		compatible = "mediatek,mcu_misccfg";
		reg = <0x00 0xc530400 0x00 0x1000>;
	};

	mcu_misc1cfg@0c530800 {
		compatible = "mediatek,mcu_misc1cfg";
		reg = <0x00 0xc530800 0x00 0x1000>;
	};

	mp2_ca15m_config@0c532000 {
		compatible = "mediatek,mp2_ca15m_config";
		reg = <0x00 0xc532000 0x00 0x1000>;
	};

	mcucfg_mp0_counter@0c530000 {
		compatible = "mediatek,mcucfg_mp0_counter";
		reg = <0x00 0xc530000 0x00 0x2000>;
	};

	mcucfg_mp2_counter@0c532000 {
		compatible = "mediatek,mcucfg_mp2_counter";
		reg = <0x00 0xc532000 0x00 0x1000>;
	};

	infracfg@1020e000 {
		compatible = "mediatek,infracfg";
		reg = <0x00 0x1020e000 0x00 0x1000>;
	};

	sramrom@10214000 {
		compatible = "mediatek,sramrom";
		reg = <0x00 0x10214000 0x00 0x1000>;
	};

	emi@10219000 {
		compatible = "mediatek,emi";
		reg = <0x00 0x10219000 0x00 0x1000 0x00 0x10226000 0x00 0x1000 0x00 0x1022d000 0x00 0x1000 0x00 0x10235000 0x00 0x1000>;
		interrupts = <0x00 0x93 0x08 0x00 0x94 0x04 0x00 0x9b 0x04>;
	};

	sys_cirq@10204000 {
		compatible = "mediatek,sys_cirq";
		reg = <0x00 0x10204000 0x00 0x1000>;
		mediatek,cirq_num = <0xe7>;
		mediatek,spi_start_offset = <0x48>;
		interrupts = <0x00 0x12f 0x08>;
	};

	m4u@10205000 {
		cell-index = <0x00>;
		compatible = "mediatek,m4u";
		reg = <0x00 0x10205000 0x00 0x1000>;
		interrupts = <0x00 0xa6 0x08>;
	};

	devapc@10207000 {
		compatible = "mediatek,devapc";
		reg = <0x00 0x10207000 0x00 0x1000>;
		interrupts = <0x00 0x91 0x08>;
		clocks = <0x15 0x2d>;
		clock-names = "devapc-infra-clock";
	};

	bus_dbg@10208000 {
		compatible = "mediatek,bus_dbg-v2";
		reg = <0x00 0x10208000 0x00 0x1000>;
		interrupts = <0x00 0x90 0x08>;
	};

	ap_ccif0@10209000 {
		compatible = "mediatek,ap_ccif0";
		reg = <0x00 0x10209000 0x00 0x1000>;
		interrupts = <0x00 0x97 0x08>;
	};

	md_ccif0@1020a000 {
		compatible = "mediatek,md_ccif0";
		reg = <0x00 0x1020a000 0x00 0x1000>;
	};

	ap_ccif1@1020b000 {
		compatible = "mediatek,ap_ccif1";
		reg = <0x00 0x1020b000 0x00 0x1000>;
		interrupts = <0x00 0x99 0x08>;
	};

	md_ccif1@1020c000 {
		compatible = "mediatek,md_ccif1";
		reg = <0x00 0x1020c000 0x00 0x1000>;
	};

	ap_ccif2@1023c000 {
		compatible = "mediatek,ap_ccif2";
		reg = <0x00 0x1023c000 0x00 0x1000>;
		interrupts = <0x00 0x9c 0x08>;
	};

	md_ccif2@1023d000 {
		compatible = "mediatek,md_ccif2";
		reg = <0x00 0x1023d000 0x00 0x1000>;
	};

	ap_ccif3@1023e000 {
		compatible = "mediatek,ap_ccif3";
		reg = <0x00 0x1023e000 0x00 0x1000>;
		interrupts = <0x00 0x9d 0x08>;
	};

	md_ccif3@1023f000 {
		compatible = "mediatek,md_ccif3";
		reg = <0x00 0x1023f000 0x00 0x1000>;
	};

	infra_mbist@1020d000 {
		compatible = "mediatek,infra_mbist";
		reg = <0x00 0x1020d000 0x00 0x1000>;
	};

	trng@1020f000 {
		compatible = "mediatek,trng";
		reg = <0x00 0x1020f000 0x00 0x1000>;
		interrupts = <0x00 0xa9 0x08>;
	};

	dxcc_sec@10210000 {
		compatible = "mediatek,dxcc_sec";
		reg = <0x00 0x10210000 0x00 0x1000>;
		interrupts = <0x00 0xaa 0x04>;
	};

	smi_common_ao@10211000 {
		compatible = "mediatek,smi_common_ao";
		reg = <0x00 0x10211000 0x00 0x1000>;
	};

	cq_dma@10212000 {
		compatible = "mediatek,mt-cqdma-v1";
		reg = <0x00 0x10212000 0x00 0x80 0x00 0x10212080 0x00 0x80 0x00 0x10212100 0x00 0x80>;
		interrupts = <0x00 0x73 0x08 0x00 0x74 0x08 0x00 0x75 0x08>;
		nr_channel = <0x03>;
		clocks = <0x15 0x4e>;
		clock-names = "cqdma";
	};

	wifi@180f0000 {
		compatible = "mediatek,wifi";
		reg = <0x00 0x180f0000 0x00 0x1100 0x00 0x10212180 0x00 0x6c 0x00 0x10001000 0x00 0x1000 0x00 0x180e0000 0x00 0x70>;
		interrupts = <0x00 0x122 0x08 0x00 0x76 0x08>;
		clocks = <0x15 0x4e>;
		clock-names = "wifi-dma";
		hardware-values = <0x788 0xa5800 0xa5800>;
		linux,phandle = <0x66>;
		phandle = <0x66>;
	};

	mipi_tx0@11e50000 {
		compatible = "mediatek,mipi_tx0";
		reg = <0x00 0x11e50000 0x00 0x1000>;
	};

	mipi_tx1@10216000 {
		compatible = "mediatek,mipi_tx1";
		reg = <0x00 0x10216000 0x00 0x1000>;
	};

	mipi_rx_ana_csi0a@11c80000 {
		compatible = "mediatek,mipi_rx_ana_csi0a";
		reg = <0x00 0x11c80000 0x00 0x1000>;
	};

	mipi_rx_ana_csi0b@11c81000 {
		compatible = "mediatek,mipi_rx_ana_csi0b";
		reg = <0x00 0x11c81000 0x00 0x1000>;
	};

	mipi_rx_ana_csi1a@11c82000 {
		compatible = "mediatek,mipi_rx_ana_csi1a";
		reg = <0x00 0x11c82000 0x00 0x1000>;
	};

	mipi_rx_ana_csi1b@11c83000 {
		compatible = "mediatek,mipi_rx_ana_csi1b";
		reg = <0x00 0x11c83000 0x00 0x1000>;
	};

	mipi_rx_ana_csi2a@11c84000 {
		compatible = "mediatek,mipi_rx_ana_csi2a";
		reg = <0x00 0x11c84000 0x00 0x1000>;
	};

	mipi_rx_ana_csi2b@11c85000 {
		compatible = "mediatek,mipi_rx_ana_csi2b";
		reg = <0x00 0x11c85000 0x00 0x1000>;
	};

	gcpu_rsa@1021a000 {
		compatible = "mediatek,gcpu_rsa";
		reg = <0x00 0x1021a000 0x00 0x1000>;
	};

	apcldmain@1021b000 {
		compatible = "mediatek,apcldmain";
		reg = <0x00 0x1021b000 0x00 0x1000>;
	};

	apcldmaout@1021b400 {
		compatible = "mediatek,apcldmaout";
		reg = <0x00 0x1021b400 0x00 0x1000>;
	};

	apcldmamisc@1021b800 {
		compatible = "mediatek,apcldmamisc";
		reg = <0x00 0x1021b800 0x00 0x1000>;
		interrupts = <0x00 0xad 0x04>;
	};

	mdcldmain@1021c000 {
		compatible = "mediatek,mdcldmain";
		reg = <0x00 0x1021c000 0x00 0x1000>;
	};

	mdcldmaout@1021c400 {
		compatible = "mediatek,mdcldmaout";
		reg = <0x00 0x1021c400 0x00 0x1000>;
	};

	mdcldmamisc@1021c800 {
		compatible = "mediatek,mdcldmamisc";
		reg = <0x00 0x1021c800 0x00 0x1000>;
	};

	infra_md@1021d000 {
		compatible = "mediatek,infra_md";
		reg = <0x00 0x1021d000 0x00 0x1000>;
	};

	mdcldma@10014000 {
		compatible = "mediatek,mdcldma";
		reg = <0x00 0x10014000 0x00 0x1000 0x00 0x1021b000 0x00 0x1000 0x00 0x10209000 0x00 0x1000 0x00 0x1020a000 0x00 0x1000>;
		interrupts = <0x00 0xad 0x04 0x00 0x97 0x08 0x00 0x98 0x08 0x00 0x11b 0x02>;
		mediatek,md_id = <0x00>;
		mediatek,cldma_capability = <0x06>;
		clocks = <0x2b 0x01 0x15 0x37 0x15 0x2e 0x15 0x31 0x15 0x26 0x15 0x27 0x15 0x5d 0x15 0x5e>;
		clock-names = "scp-sys-md1-main\0infra-cldma-bclk\0infra-ccif-ap\0infra-ccif-md\0infra-ccif1-ap\0infra-ccif1-md\0infra-ccif2-ap\0infra-ccif2-md";
		linux,phandle = <0x29>;
		phandle = <0x29>;
	};

	infra_md_cfg@1021d000 {
		compatible = "mediatek,infra_md_cfg";
		reg = <0x00 0x1021d000 0x00 0x1000>;
	};

	bpi_bsi_slv0@1021e000 {
		compatible = "mediatek,bpi_bsi_slv0";
		reg = <0x00 0x1021e000 0x00 0x1000>;
	};

	bpi_bsi_slv1@1021f000 {
		compatible = "mediatek,bpi_bsi_slv1";
		reg = <0x00 0x1021f000 0x00 0x1000>;
	};

	bpi_bsi_slv2@10225000 {
		compatible = "mediatek,bpi_bsi_slv2";
		reg = <0x00 0x10225000 0x00 0x1000>;
	};

	dvfsp@10227000 {
		compatible = "mediatek,dvfsp";
		reg = <0x00 0x10227000 0x00 0x1000>;
		interrupts = <0x00 0xab 0x08>;
	};

	dvfsp@0011bc00 {
		compatible = "mediatek,mt6771-dvfsp";
		reg = <0x00 0x11bc00 0x00 0x1400 0x00 0x11bc00 0x00 0x1400>;
	};

	mcdi@0011b000 {
		compatible = "mediatek,mt6771-mcdi";
		reg = <0x00 0x11b000 0x00 0x800>;
	};

	dramc@1022a000 {
		compatible = "mediatek,dramc";
		reg = <0x00 0x1022a000 0x00 0x2000 0x00 0x10232000 0x00 0x2000 0x00 0x1022c000 0x00 0x1000 0x00 0x10234000 0x00 0x1000 0x00 0x10228000 0x00 0x2000 0x00 0x10230000 0x00 0x2000 0x00 0x1022e000 0x00 0x1000 0x00 0x10236000 0x00 0x1000>;
	};

	fmem_smi@10238000 {
		compatible = "mediatek,fmem_smi";
		reg = <0x00 0x10238000 0x00 0x1000>;
	};

	gce@10238000 {
		compatible = "mediatek,gce";
		reg = <0x00 0x10238000 0x00 0x1000>;
		interrupts = <0x00 0xa2 0x08 0x00 0xa3 0x08>;
		disp_mutex_reg = <0x14016000 0x1000>;
		g3d_config_base = <0x13000000 0x00 0xffff0000>;
		mmsys_config_base = <0x14000000 0x01 0xffff0000>;
		disp_dither_base = <0x14010000 0x02 0xffff0000>;
		mm_na_base = <0x14020000 0x03 0xffff0000>;
		imgsys_base = <0x15020000 0x04 0xffff0000>;
		vdec_gcon_base = <0x18800000 0x05 0xffff0000>;
		venc_gcon_base = <0x18810000 0x06 0xffff0000>;
		conn_peri_base = <0x18820000 0x07 0xffff0000>;
		topckgen_base = <0x18830000 0x08 0xffff0000>;
		kp_base = <0x18840000 0x09 0xffff0000>;
		scp_sram_base = <0x10000000 0x0a 0xffff0000>;
		infra_na3_base = <0x10010000 0x0b 0xffff0000>;
		infra_na4_base = <0x10020000 0x0c 0xffff0000>;
		scp_base = <0x10030000 0x0d 0xffff0000>;
		mcucfg_base = <0x10040000 0x0e 0xffff0000>;
		gcpu_base = <0x10050000 0x0f 0xffff0000>;
		usb0_base = <0x10200000 0x10 0xffff0000>;
		usb_sif_base = <0x10280000 0x11 0xffff0000>;
		audio_base = <0x17000000 0x12 0xffff0000>;
		vdec_base = <0x17010000 0x13 0xffff0000>;
		msdc2_base = <0x17020000 0x14 0xffff0000>;
		vdec1_base = <0x17030000 0x15 0xffff0000>;
		msdc3_base = <0x18000000 0x16 0xffff0000>;
		ap_dma_base = <0x18010000 0x17 0xffff0000>;
		gce_base = <0x18020000 0x18 0xffff0000>;
		vdec2_base = <0x18040000 0x19 0xffff0000>;
		vdec3_base = <0x18050000 0x1a 0xffff0000>;
		camsys_base = <0x18080000 0x1b 0xffff0000>;
		camsys1_base = <0x180a0000 0x1c 0xffff0000>;
		camsys2_base = <0x180b0000 0x1d 0xffff0000>;
		pwm_sw_base = <0x11000000 0x63 0xffff0000>;
		disp_rdma0_sof = <0x00>;
		disp_rdma1_sof = <0x01>;
		mdp_rdma0_sof = <0x02>;
		mdp_rsz0_sof = <0x04>;
		mdp_rsz1_sof = <0x05>;
		mdp_tdshp_sof = <0x06>;
		mdp_wrot0_sof = <0x07>;
		mdp_wdma_sof = <0x08>;
		disp_ovl0_sof = <0x09>;
		disp_2l_ovl0_sof = <0x0a>;
		disp_2l_ovl1_sof = <0x0b>;
		disp_wdma0_sof = <0x0c>;
		disp_color0_sof = <0x0d>;
		disp_ccorr0_sof = <0x0e>;
		disp_aal0_sof = <0x0f>;
		disp_gamma0_sof = <0x10>;
		disp_dither0_sof = <0x11>;
		disp_pwm0_sof = <0x12>;
		disp_dsi0_sof = <0x13>;
		disp_dpi0_sof = <0x14>;
		disp_rsz0_sof = <0x16>;
		mdp_aal_sof = <0x17>;
		mdp_ccorr_sof = <0x18>;
		disp_dbi0_sof = <0x19>;
		disp_rdma0_frame_done = <0x1a>;
		disp_rdma1_frame_done = <0x1b>;
		mdp_rdma0_frame_done = <0x1c>;
		mdp_rsz0_frame_done = <0x1e>;
		mdp_rsz1_frame_done = <0x1f>;
		mdp_tdshp_frame_done = <0x20>;
		mdp_wrot0_write_frame_done = <0x21>;
		mdp_wdma_frame_done = <0x22>;
		disp_ovl0_frame_done = <0x23>;
		disp_2l_ovl0_frame_done = <0x24>;
		disp_2l_ovl1_frame_done = <0x25>;
		disp_wdma0_frame_done = <0x26>;
		disp_color0_frame_done = <0x27>;
		disp_ccorr0_frame_done = <0x28>;
		disp_aal0_frame_done = <0x29>;
		disp_gamma0_frame_done = <0x2a>;
		disp_dither0_frame_done = <0x2b>;
		disp_dsi0_frame_done = <0x2c>;
		disp_dpi0_frame_done = <0x2d>;
		disp_rsz0_frame_done = <0x2f>;
		mdp_aal_frame_done = <0x30>;
		mdp_ccorr_frame_done = <0x31>;
		disp_dbi0_frame_done = <0x32>;
		stream_done_0 = <0x82>;
		stream_done_1 = <0x83>;
		stream_done_2 = <0x84>;
		stream_done_3 = <0x85>;
		stream_done_4 = <0x86>;
		stream_done_5 = <0x87>;
		stream_done_6 = <0x88>;
		stream_done_7 = <0x89>;
		stream_done_8 = <0x8a>;
		stream_done_9 = <0x8b>;
		stream_done_10 = <0x8c>;
		stream_done_11 = <0x8d>;
		buf_underrun_event_0 = <0x8e>;
		buf_underrun_event_1 = <0x8f>;
		dsi0_te_event = <0x90>;
		dsi0_irq_event = <0x91>;
		dsi0_done_event = <0x92>;
		disp_wdma0_rst_done = <0x96>;
		mdp_wdma_rst_done = <0x97>;
		mdp_wrot0_rst_done = <0x98>;
		mdp_rdma0_rst_done = <0x9a>;
		disp_ovl0_frame_rst_done_pusle = <0x9b>;
		disp_ovl0_2l_frame_rst_done_pusle = <0x9c>;
		disp_ovl1_2l_frame_rst_done_pusle = <0x9d>;
		dip_cq_thread0_frame_done = <0x101>;
		dip_cq_thread1_frame_done = <0x102>;
		dip_cq_thread2_frame_done = <0x103>;
		dip_cq_thread3_frame_done = <0x104>;
		dip_cq_thread4_frame_done = <0x105>;
		dip_cq_thread5_frame_done = <0x106>;
		dip_cq_thread6_frame_done = <0x107>;
		dip_cq_thread7_frame_done = <0x108>;
		dip_cq_thread8_frame_done = <0x109>;
		dip_cq_thread9_frame_done = <0x10a>;
		dip_cq_thread10_frame_done = <0x10b>;
		dip_cq_thread11_frame_done = <0x10c>;
		dip_cq_thread12_frame_done = <0x10d>;
		dip_cq_thread13_frame_done = <0x10e>;
		dip_cq_thread14_frame_done = <0x10f>;
		dip_cq_thread15_frame_done = <0x110>;
		dip_cq_thread16_frame_done = <0x111>;
		dip_cq_thread17_frame_done = <0x112>;
		dip_cq_thread18_frame_done = <0x113>;
		amd_frame_done = <0x114>;
		dve_frame_done = <0x115>;
		wmf_frame_done = <0x116>;
		rsc_frame_done = <0x117>;
		mfb_done = <0x118>;
		wpe_a_frame_done = <0x119>;
		wpe_b_frame_done = <0x11a>;
		occ_done = <0x11b>;
		venc_done = <0x121>;
		jpgenc_done = <0x122>;
		jpgdec_done = <0x123>;
		venc_mb_done = <0x124>;
		venc_128byte_cnt_done = <0x125>;
		isp_frame_done_a = <0x141>;
		isp_frame_done_b = <0x142>;
		camsv_0_pass1_done = <0x143>;
		camsv_1_pass1_done = <0x144>;
		camsv_2_pass1_done = <0x145>;
		tsf_done = <0x146>;
		seninf_0_fifo_full = <0x147>;
		seninf_1_fifo_full = <0x148>;
		seninf_2_fifo_full = <0x149>;
		seninf_3_fifo_full = <0x14a>;
		seninf_4_fifo_full = <0x14b>;
		seninf_5_fifo_full = <0x14c>;
		seninf_6_fifo_full = <0x14d>;
		seninf_7_fifo_full = <0x14e>;
		ipu_done_0 = <0x161>;
		ipu_done_1 = <0x162>;
		ipu_done_2 = <0x163>;
		ipu_done_3 = <0x164>;
		ipu_done_1_0 = <0x181>;
		ipu_done_1_1 = <0x182>;
		ipu_done_1_2 = <0x183>;
		ipu_done_1_3 = <0x184>;
		max_prefetch_cnt = <0x04>;
		prefetch_size = <0xa0 0x20 0x20 0x20>;
		sram_size_cpr_64 = <0x88>;
		mmsys_config = <0x2c>;
		mm_mutex = <0x2d>;
		mdp_rdma0 = <0x2e>;
		mdp_rdma1 = <0x2f>;
		mdp_rsz0 = <0x30>;
		mdp_rsz1 = <0x31>;
		mdp_wrot0 = <0x32>;
		mdp_wdma0 = <0x33>;
		mdp_tdshp0 = <0x34>;
		mdp_aal0 = <0x35>;
		mdp_ccorr0 = <0x36>;
		mdp_color0 = <0x37>;
		venc = <0x38>;
		msdc0 = <0x39>;
		audio = <0x3a>;
		uart = <0x3b>;
		smi_larb0 = <0x3c>;
		sram_share_cnt = <0x01>;
		sram_share_engine = <0x18>;
		sram_share_event = <0x2c6>;
		clocks = <0x15 0x09 0x15 0x19>;
		clock-names = "GCE\0GCE_TIMER";
	};

	gic@1023a000 {
		compatible = "mediatek,gic";
		reg = <0x00 0x1023a000 0x00 0x1000>;
	};

	ap_dma@11000000 {
		compatible = "mediatek,ap_dma";
		reg = <0x00 0x11000000 0x00 0x1000>;
		interrupts = <0x00 0x5e 0x08>;
	};

	auxadc@11001000 {
		compatible = "mediatek,auxadc";
		reg = <0x00 0x11001000 0x00 0x1000>;
		interrupts = <0x00 0x4a 0x02>;
		clocks = <0x15 0x24>;
		clock-names = "auxadc-main";
		linux,phandle = <0x67>;
		phandle = <0x67>;
	};

	dma-controller@11000780 {
		compatible = "mediatek,mt6577-uart-dma";
		reg = <0x00 0x11000780 0x00 0x80 0x00 0x11000800 0x00 0x80 0x00 0x11000880 0x00 0x80 0x00 0x11000900 0x00 0x80 0x00 0x11000980 0x00 0x80 0x00 0x11000a00 0x00 0x80>;
		interrupts = <0x00 0x6c 0x08 0x00 0x6d 0x08 0x00 0x6e 0x08 0x00 0x6f 0x08 0x00 0x70 0x08 0x00 0x71 0x08>;
		clocks = <0x15 0x2b>;
		clock-names = "apdma";
		#dma-cells = <0x01>;
		dma-bits = <0x22>;
		linux,phandle = <0x3e>;
		phandle = <0x3e>;
	};

	serial@11002000 {
		compatible = "mediatek,mt6577-uart";
		reg = <0x00 0x11002000 0x00 0x1000>;
		interrupts = <0x00 0x5b 0x08>;
		clocks = <0x3d 0x15 0x15>;
		clock-names = "baud\0bus";
		dmas = <0x3e 0x00 0x3e 0x01>;
		dma-names = "tx\0rx";
		linux,phandle = <0x3b>;
		phandle = <0x3b>;
	};

	serial@11003000 {
		compatible = "mediatek,mt6577-uart";
		reg = <0x00 0x11003000 0x00 0x1000>;
		interrupts = <0x00 0x5c 0x08>;
		clocks = <0x3d 0x15 0x16>;
		clock-names = "baud\0bus";
		dmas = <0x3e 0x02 0x3e 0x03>;
		dma-names = "tx\0rx";
		linux,phandle = <0x68>;
		phandle = <0x68>;
	};

	serial@11004000 {
		compatible = "mediatek,mt6577-uart";
		reg = <0x00 0x11004000 0x00 0x1000>;
		interrupts = <0x00 0x5d 0x08>;
		clocks = <0x3d 0x15 0x17>;
		clock-names = "baud\0bus";
		dmas = <0x3e 0x04 0x3e 0x05>;
		dma-names = "tx\0rx";
		linux,phandle = <0x69>;
		phandle = <0x69>;
	};

	i2c6@11005000 {
		compatible = "mediatek,i2c6";
		reg = <0x00 0x11005000 0x00 0x1000>;
		interrupts = <0x00 0x57 0x08>;
	};

	pwm@11006000 {
		compatible = "mediatek,pwm";
		reg = <0x00 0x11006000 0x00 0x1000>;
		interrupts = <0x00 0x4b 0x08>;
		clocks = <0x15 0x10 0x15 0x11 0x15 0x12 0x15 0x13 0x15 0x0f 0x15 0x14>;
		clock-names = "PWM1-main\0PWM2-main\0PWM3-main\0PWM4-main\0PWM-HCLK-main\0PWM-main";
	};

	spi@1100a000 {
		compatible = "mediatek,mt6771-spi";
		mediatek,pad-select = <0x00>;
		reg = <0x00 0x1100a000 0x00 0x1000>;
		interrupts = <0x00 0x78 0x08>;
		clocks = <0x3f 0x37 0x3f 0x07 0x15 0x1c>;
		clock-names = "parent-clk\0sel-clk\0spi-clk";
		linux,phandle = <0x6a>;
		phandle = <0x6a>;
	};

	spi@11010000 {
		compatible = "mediatek,mt6771-spi";
		mediatek,pad-select = <0x00>;
		reg = <0x00 0x11010000 0x00 0x1000>;
		interrupts = <0x00 0x7c 0x08>;
		clocks = <0x3f 0x37 0x3f 0x07 0x15 0x39>;
		clock-names = "parent-clk\0sel-clk\0spi-clk";
		linux,phandle = <0x6b>;
		phandle = <0x6b>;
	};

	spi@11012000 {
		compatible = "mediatek,mt6771-spi";
		mediatek,pad-select = <0x00>;
		reg = <0x00 0x11012000 0x00 0x1000>;
		interrupts = <0x00 0x81 0x08>;
		clocks = <0x3f 0x37 0x3f 0x07 0x15 0x3c>;
		clock-names = "parent-clk\0sel-clk\0spi-clk";
		linux,phandle = <0x6c>;
		phandle = <0x6c>;
	};

	spi@11013000 {
		compatible = "mediatek,mt6771-spi";
		mediatek,pad-select = <0x00>;
		reg = <0x00 0x11013000 0x00 0x1000>;
		interrupts = <0x00 0x82 0x08>;
		clocks = <0x3f 0x37 0x3f 0x07 0x15 0x3d>;
		clock-names = "parent-clk\0sel-clk\0spi-clk";
		linux,phandle = <0x6d>;
		phandle = <0x6d>;
	};

	spi@11018000 {
		compatible = "mediatek,mt6771-spi";
		mediatek,pad-select = <0x00>;
		reg = <0x00 0x11018000 0x00 0x1000>;
		interrupts = <0x00 0x86 0x08>;
		clocks = <0x3f 0x37 0x3f 0x07 0x15 0x4c>;
		clock-names = "parent-clk\0sel-clk\0spi-clk";
		linux,phandle = <0x6e>;
		phandle = <0x6e>;
	};

	spi@11019000 {
		compatible = "mediatek,mt6771-spi";
		mediatek,pad-select = <0x00>;
		reg = <0x00 0x11019000 0x00 0x1000>;
		interrupts = <0x00 0x87 0x08>;
		clocks = <0x3f 0x37 0x3f 0x07 0x15 0x4d>;
		clock-names = "parent-clk\0sel-clk\0spi-clk";
		linux,phandle = <0x6f>;
		phandle = <0x6f>;
	};

	therm_ctrl@1100b000 {
		compatible = "mediatek,therm_ctrl";
		reg = <0x00 0x1100b000 0x00 0x1000>;
		interrupts = <0x00 0x4c 0x08>;
		clocks = <0x15 0x0a>;
		clock-names = "therm-main";
	};

	eem_fsm@1100b000 {
		compatible = "mediatek,eem_fsm";
		reg = <0x00 0x1100b000 0x00 0x1000>;
		interrupts = <0x00 0x7f 0x08>;
	};

	btif@1100c000 {
		compatible = "mediatek,btif";
		reg = <0x00 0x1100c000 0x00 0x1000 0x00 0x11000a80 0x00 0x80 0x00 0x11000b00 0x00 0x80>;
		interrupts = <0x00 0x72 0x08 0x00 0x8b 0x08 0x00 0x8c 0x08>;
		clocks = <0x15 0x1b 0x15 0x2b>;
		clock-names = "btifc\0apdmac";
	};

	consys@18070000 {
		compatible = "mediatek,mt6771-consys";
		reg = <0x00 0x18070000 0x00 0x1000 0x00 0x10007000 0x00 0x100 0x00 0x10001000 0x00 0x1000 0x00 0x10006000 0x00 0x1000>;
		interrupts = <0x00 0x121 0x08 0x00 0x123 0x08>;
		clocks = <0x2b 0x02>;
		clock-names = "conn";
		linux,phandle = <0x28>;
		phandle = <0x28>;
	};

	irtx@1100d000 {
		compatible = "mediatek,irtx";
		reg = <0x00 0x1100d000 0x00 0x1000>;
	};

	irtx_pwm {
		compatible = "mediatek,irtx-pwm";
		pwm_ch = <0x00>;
		pwm_data_invert = <0x00>;
		linux,phandle = <0x70>;
		phandle = <0x70>;
	};

	disp_pwm0@1100e000 {
		compatible = "mediatek,disp_pwm0";
		reg = <0x00 0x1100e000 0x00 0x1000>;
		interrupts = <0x00 0x80 0x08>;
	};

	usb3@11200000 {
		compatible = "mediatek,usb3";
		reg = <0x00 0x11200000 0x00 0x10000 0x00 0x11203e00 0x00 0x100 0x00 0x11f40000 0x00 0x10000>;
		reg-names = "ssusb_base\0ssusb_ippc\0ssusb_sif2";
		interrupts = <0x00 0x48 0x08 0x00 0x49 0x08>;
		interrupt-names = "musb-hdrc\0xhci";
		debug_level = <0x06>;
		fgpa_i2c_physical_base = <0x11009000>;
		linux,phandle = <0x71>;
		phandle = <0x71>;
	};

	usb3_xhci@11200000 {
		compatible = "mediatek,mt67xx-xhci";
		reg = <0x00 0x11200000 0x00 0x10000 0x00 0x11203e00 0x00 0x100>;
		reg-names = "ssusb_base\0ssusb_ippc";
		interrupts = <0x00 0x49 0x08>;
		interrupt-names = "xhci";
		linux,phandle = <0x72>;
		phandle = <0x72>;
	};

	btcvsd@10001000 {
		compatible = "mediatek,audio_bt_cvsd";
		offset = <0xf00 0x800 0xfd0 0xfd4 0xfd8>;
		reg = <0x00 0x10001000 0x00 0x1000 0x00 0x18000000 0x00 0x1000 0x00 0x18080000 0x00 0x10000>;
		interrupts = <0x00 0x120 0x08>;
	};

	audio@11220000 {
		compatible = "mediatek,audio\0syscon";
		reg = <0x00 0x11220000 0x00 0x1000>;
		#clock-cells = <0x01>;
		linux,phandle = <0x3a>;
		phandle = <0x3a>;
	};

	mt_soc_dl1_pcm@11220000 {
		compatible = "mediatek,mt_soc_pcm_dl1";
		reg = <0x00 0x11220000 0x00 0x1000>;
		interrupts = <0x00 0xa1 0x08>;
		clocks = <0x3a 0x09 0x3a 0x03 0x3a 0x02 0x3a 0x04 0x3a 0x0e 0x3a 0x08 0x3a 0x07 0x3a 0x05 0x3a 0x06 0x3a 0x01 0x2b 0x08 0x15 0x30 0x15 0x38 0x3f 0x0c 0x3f 0x0d 0x3f 0x31 0x3f 0x14 0x3f 0x49 0x3f 0x15 0x3f 0x4d 0x3f 0x1f 0x3f 0x4c 0x3f 0x20 0x3f 0x50 0x3d>;
		clock-names = "aud_afe_clk\0aud_dac_clk\0aud_dac_predis_clk\0aud_adc_clk\0aud_adc_adda6_clk\0aud_apll22m_clk\0aud_apll24m_clk\0aud_apll1_tuner_clk\0aud_apll2_tuner_clk\0aud_tml_clk\0scp_sys_audio\0aud_infra_clk\0mtkaif_26m_clk\0top_mux_audio\0top_mux_audio_int\0top_syspll_d2_d4\0top_mux_aud_1\0top_apll1_ck\0top_mux_aud_2\0top_apll2_ck\0top_mux_aud_eng1\0top_apll1_d8\0top_mux_aud_eng2\0top_apll2_d8\0top_clk26m_clk";
		linux,phandle = <0x73>;
		phandle = <0x73>;
	};

	audio_sram@11221000 {
		compatible = "mediatek,audio_sram";
		reg = <0x00 0x11221000 0x00 0xc000>;
	};

	ufshci@11270000 {
		compatible = "mediatek,ufshci";
		reg = <0x00 0x11270000 0x00 0x2300>;
		interrupts = <0x00 0x50 0x08>;
		clocks = <0x15 0x4f 0x15 0x3e 0x15 0x40>;
		clock-names = "ufs0-clock\0ufs0-unipro-clk\0ufs0-mp-clk";
		freq-table-hz = <0x00 0x00 0x00 0x00 0x00 0x00>;
		vcc-supply = <0x14>;
		vcc-fixed-regulator;
		mediatek,auto-hibern8-timer = <0x0a>;
		mediatek,spm-level = <0x03>;
		mediatek,rpm-enable = <0x01>;
		mediatek,rpm-autosuspend-delay = <0x7d0>;
		mediatek,rpm-level = <0x03>;
		linux,phandle = <0x74>;
		phandle = <0x74>;
	};

	ca9peri@10e00000 {
		compatible = "mediatek,ca9peri";
		reg = <0x00 0x10e00000 0x00 0x1000>;
	};

	l2c@10f00000 {
		compatible = "mediatek,l2c";
		reg = <0x00 0x10f00000 0x00 0x1000>;
	};

	efusec@11f10000 {
		compatible = "mediatek,efusec";
		reg = <0x00 0x11f10000 0x00 0x1000>;
	};

	ufs_mphy@11fa0000 {
		compatible = "mediatek,ufs_mphy";
		reg = <0x00 0x11fa0000 0x00 0xc000>;
	};

	mfgcfg@13000000 {
		compatible = "mediatek,mfgcfg\0syscon";
		reg = <0x00 0x13000000 0x00 0x1000 0x00 0x10001000 0x00 0x1000 0x00 0x10006000 0x00 0x1000 0x00 0x1020e000 0x00 0x1000 0x00 0xd000000 0x00 0xf0000>;
		#clock-cells = <0x01>;
		linux,phandle = <0x40>;
		phandle = <0x40>;
	};

	mali@13040000 {
		compatible = "mediatek,mali\0arm,mali-midgard\0arm,mali-bifrost";
		reg = <0x00 0x13040000 0x00 0x4000>;
		interrupts = <0x00 0x116 0x08 0x00 0x117 0x08 0x00 0x118 0x08>;
		interrupt-names = "GPU\0MMU\0JOB";
	};

	gpufreq {
		compatible = "mediatek,mt6771-gpufreq";
		clocks = <0x3f 0x04 0x3f 0x61 0x3d 0x40 0x01 0x2b 0x07 0x2b 0x04 0x2b 0x0b 0x2b 0x0a 0x2b 0x0c>;
		clock-names = "clk_mux\0clk_main_parent\0clk_sub_parent\0subsys_mfg_cg\0mtcmos_mfg_async\0mtcmos_mfg\0mtcmos_mfg_core0\0mtcmos_mfg_core1\0mtcmos_mfg_core2";
	};

	mali_tb@1307f000 {
		compatible = "mediatek,mali_tb";
		reg = <0x00 0x1307f000 0x00 0x1000>;
	};

	mfg_dfp_60@13020000 {
		compatible = "mediatek,mfg_dfp_60";
		reg = <0x00 0x13020000 0x00 0x1000>;
		interrupts = <0x00 0x11a 0x08>;
	};

	mfg_tb@13ffef00 {
		compatible = "mediatek,mfg_tb";
		reg = <0x00 0x13ffef00 0x00 0x1000>;
	};

	mmsys_config@14000000 {
		compatible = "mediatek,mmsys_config\0syscon";
		reg = <0x00 0x14000000 0x00 0x1000>;
		interrupts = <0x00 0xef 0x08>;
		#clock-cells = <0x01>;
		clocks = <0x2c 0x0b 0x2c 0x25 0x2c 0x0c 0x2c 0x26>;
		clock-names = "CAM_MDP_TX\0CAM_MDP_RX\0CAM_MDP2_TX\0CAM_MDP2_RX";
		linux,phandle = <0x2c>;
		phandle = <0x2c>;
	};

	touch_pad {
		compatible = "mediatek,touch_pad";
		linux,phandle = <0x75>;
		phandle = <0x75>;
	};

	touch {
		compatible = "mediatek,mt6771-touch";
		linux,phandle = <0x76>;
		phandle = <0x76>;
	};

	hall_1 {
		compatible = "mediatek,hall_1";
		linux,phandle = <0x77>;
		phandle = <0x77>;
	};

	pah8011 {
		compatible = "mediatek,heartrate";
		linux,phandle = <0x78>;
		phandle = <0x78>;
	};

	lepton {
		compatible = "agold,flir_lepton";
		linux,phandle = <0x79>;
		phandle = <0x79>;
	};

	remote {
		compatible = "mediatek,remote";
		linux,phandle = <0x7a>;
		phandle = <0x7a>;
	};

	accdet {
		compatible = "mediatek,pmic-accdet";
		linux,phandle = <0x7b>;
		phandle = <0x7b>;
	};

	mt6358_gauge {
		compatible = "mediatek,mt6358_gauge";
		gauge_name = "gauge";
		alias_name = "MT6358";
	};

	gauge_timer {
		compatible = "mediatek,gauge_timer_service";
	};

	battery {
		compatible = "mediatek,bat_gm30";
		DIFFERENCE_FULLOCV_ITH = <0xc8>;
		SHUTDOWN_1_TIME = <0x1e>;
		KEEP_100_PERCENT = <0x01>;
		R_FG_VALUE = <0x0a>;
		EMBEDDED_SEL = <0x00>;
		PMIC_SHUTDOWN_CURRENT = <0x14>;
		FG_METER_RESISTANCE = <0x4b>;
		CAR_TUNE_VALUE = <0x64>;
		PMIC_MIN_VOL = <0x82dc>;
		POWERON_SYSTEM_IBOOT = <0x1f4>;
		SHUTDOWN_GAUGE0_VOLTAGE = <0x84d0>;
		TEMPERATURE_T0 = <0x32>;
		TEMPERATURE_T1 = <0x19>;
		TEMPERATURE_T2 = <0x0a>;
		TEMPERATURE_T3 = <0x00>;
		TEMPERATURE_T4 = <0xfffffff6>;
		g_FG_PSEUDO100_T0 = <0x64>;
		g_FG_PSEUDO100_T1 = <0x64>;
		g_FG_PSEUDO100_T2 = <0x64>;
		g_FG_PSEUDO100_T3 = <0x64>;
		g_FG_PSEUDO100_T4 = <0x64>;
		Q_MAX_SYS_VOLTAGE_BAT0 = <0xd16>;
		Q_MAX_SYS_VOLTAGE_BAT1 = <0xd16>;
		Q_MAX_SYS_VOLTAGE_BAT2 = <0xd16>;
		Q_MAX_SYS_VOLTAGE_BAT3 = <0xd16>;
		battery0_profile_t0_num = <0x64>;
		battery0_profile_t0 = <0x00 0xa96a 0x47e 0x133 0xa8b8 0x47e 0x266 0xa818 0x47e 0x398 0xa797 0x47e 0x4cb 0xa717 0x473 0x5fe 0xa698 0x467 0x731 0xa629 0x476 0x863 0xa5b8 0x48d 0x996 0xa543 0x4ab 0xac9 0xa4cf 0x4a3 0xbfc 0xa45c 0x49a 0xd2e 0xa3ed 0x4aa 0xe61 0xa37f 0x4b0 0xf94 0xa310 0x4b0 0x10c7 0xa2a8 0x4bf 0x11fa 0xa23d 0x4c4 0x132c 0xa1cf 0x4b5 0x145f 0xa165 0x4c6 0x1592 0xa0fd 0x4e3 0x16c5 0xa09b 0x4f2 0x17f7 0xa036 0x4fb 0x192a 0x9fce 0x4fb 0x1a5d 0x9f6f 0x52d 0x1b90 0x9f13 0x567 0x1cc2 0x9eb7 0x595 0x1df5 0x9e58 0x5b2 0x1f28 0x9df6 0x5c2 0x205b 0x9d99 0x5df 0x218d 0x9d3d 0x607 0x22c0 0x9ce1 0x644 0x23f3 0x9c89 0x66d 0x2526 0x9c33 0x68b 0x2659 0x9be4 0x69b 0x278b 0x9b94 0x6b0 0x28be 0x9b44 0x6cf 0x29f1 0x9af4 0x6ee 0x2b24 0x9aa6 0x70a 0x2c56 0x9a5c 0x71a 0x2d89 0x9a06 0x709 0x2ebc 0x99a4 0x6db 0x2fef 0x9937 0x685 0x3121 0x98c7 0x61d 0x3254 0x9852 0x593 0x3387 0x97e5 0x539 0x34ba 0x977d 0x4fb 0x35ed 0x9733 0x4cd 0x371f 0x96ee 0x4b6 0x3852 0x96b0 0x4c5 0x3985 0x9678 0x4c9 0x3ab8 0x9641 0x4c9 0x3bea 0x9610 0x4c9 0x3d1d 0x95e2 0x4d8 0x3e50 0x95b7 0x4f6 0x3f83 0x9587 0x4ee 0x40b5 0x9558 0x4e5 0x41e8 0x9533 0x4f5 0x431b 0x950b 0x504 0x444e 0x94e0 0x513 0x4581 0x94bb 0x523 0x46b3 0x9498 0x532 0x47e6 0x9479 0x541 0x4919 0x9456 0x546 0x4a4c 0x9432 0x546 0x4b7e 0x940d 0x546 0x4cb1 0x93e8 0x546 0x4de4 0x93c3 0x546 0x4f17 0x93a3 0x552 0x5049 0x9383 0x55f 0x517c 0x935e 0x55f 0x52af 0x9335 0x55f 0x53e2 0x930a 0x55f 0x5515 0x92da 0x55f 0x5647 0x92a5 0x550 0x577a 0x9267 0x522 0x58ad 0x922e 0x529 0x59e0 0x91f5 0x544 0x5b12 0x919f 0x526 0x5c45 0x9147 0x521 0x5d78 0x90eb 0x540 0x5eab 0x9080 0x521 0x5fdd 0x9020 0x4f8 0x6110 0x9007 0x4e9 0x6243 0x8ff9 0x4fb 0x6376 0x8ff3 0x529 0x64a8 0x8fe7 0x557 0x65db 0x8fd9 0x596 0x670e 0x8fc6 0x601 0x6841 0x8f35 0x627 0x6974 0x8e5a 0x628 0x6aa6 0x8c8e 0x675 0x6bd9 0x8ad9 0x6fd 0x6d0c 0x894a 0x7e3 0x6e3f 0x88a4 0x8e1 0x6f71 0x8847 0x9eb 0x70a4 0x87de 0xb1e 0x71d7 0x86ef 0xc0c 0x730a 0x8579 0xcb5 0x743c 0x8253 0x1102 0x756f 0x7e82 0x1a75 0x76a2 0x75f8 0x170c>;
		battery0_profile_t1_num = <0x64>;
		battery0_profile_t1 = <0x00 0xa96a 0x47e 0x133 0xa8b8 0x47e 0x266 0xa818 0x47e 0x398 0xa797 0x47e 0x4cb 0xa717 0x473 0x5fe 0xa698 0x467 0x731 0xa629 0x476 0x863 0xa5b8 0x48d 0x996 0xa543 0x4ab 0xac9 0xa4cf 0x4a3 0xbfc 0xa45c 0x49a 0xd2e 0xa3ed 0x4aa 0xe61 0xa37f 0x4b0 0xf94 0xa310 0x4b0 0x10c7 0xa2a8 0x4bf 0x11fa 0xa23d 0x4c4 0x132c 0xa1cf 0x4b5 0x145f 0xa165 0x4c6 0x1592 0xa0fd 0x4e3 0x16c5 0xa09b 0x4f2 0x17f7 0xa036 0x4fb 0x192a 0x9fce 0x4fb 0x1a5d 0x9f6f 0x52d 0x1b90 0x9f13 0x567 0x1cc2 0x9eb7 0x595 0x1df5 0x9e58 0x5b2 0x1f28 0x9df6 0x5c2 0x205b 0x9d99 0x5df 0x218d 0x9d3d 0x607 0x22c0 0x9ce1 0x644 0x23f3 0x9c89 0x66d 0x2526 0x9c33 0x68b 0x2659 0x9be4 0x69b 0x278b 0x9b94 0x6b0 0x28be 0x9b44 0x6cf 0x29f1 0x9af4 0x6ee 0x2b24 0x9aa6 0x70a 0x2c56 0x9a5c 0x71a 0x2d89 0x9a06 0x709 0x2ebc 0x99a4 0x6db 0x2fef 0x9937 0x685 0x3121 0x98c7 0x61d 0x3254 0x9852 0x593 0x3387 0x97e5 0x539 0x34ba 0x977d 0x4fb 0x35ed 0x9733 0x4cd 0x371f 0x96ee 0x4b6 0x3852 0x96b0 0x4c5 0x3985 0x9678 0x4c9 0x3ab8 0x9641 0x4c9 0x3bea 0x9610 0x4c9 0x3d1d 0x95e2 0x4d8 0x3e50 0x95b7 0x4f6 0x3f83 0x9587 0x4ee 0x40b5 0x9558 0x4e5 0x41e8 0x9533 0x4f5 0x431b 0x950b 0x504 0x444e 0x94e0 0x513 0x4581 0x94bb 0x523 0x46b3 0x9498 0x532 0x47e6 0x9479 0x541 0x4919 0x9456 0x546 0x4a4c 0x9432 0x546 0x4b7e 0x940d 0x546 0x4cb1 0x93e8 0x546 0x4de4 0x93c3 0x546 0x4f17 0x93a3 0x552 0x5049 0x9383 0x55f 0x517c 0x935e 0x55f 0x52af 0x9335 0x55f 0x53e2 0x930a 0x55f 0x5515 0x92da 0x55f 0x5647 0x92a5 0x550 0x577a 0x9267 0x522 0x58ad 0x922e 0x529 0x59e0 0x91f5 0x544 0x5b12 0x919f 0x526 0x5c45 0x9147 0x521 0x5d78 0x90eb 0x540 0x5eab 0x9080 0x521 0x5fdd 0x9020 0x4f8 0x6110 0x9007 0x4e9 0x6243 0x8ff9 0x4fb 0x6376 0x8ff3 0x529 0x64a8 0x8fe7 0x557 0x65db 0x8fd9 0x596 0x670e 0x8fc6 0x601 0x6841 0x8f35 0x627 0x6974 0x8e5a 0x628 0x6aa6 0x8c8e 0x675 0x6bd9 0x8ad9 0x6fd 0x6d0c 0x894a 0x7e3 0x6e3f 0x88a4 0x8e1 0x6f71 0x8847 0x9eb 0x70a4 0x87de 0xb1e 0x71d7 0x86ef 0xc0c 0x730a 0x8579 0xcb5 0x743c 0x8253 0x1102 0x756f 0x7e82 0x1a75 0x76a2 0x75f8 0x170c>;
		battery0_profile_t2_num = <0x64>;
		battery0_profile_t2 = <0x00 0xa9ba 0x4e2 0x133 0xa8fc 0x4e2 0x266 0xa815 0x50f 0x398 0xa6e8 0x58a 0x4cb 0xa5f2 0x682 0x5fe 0xa516 0x796 0x731 0xa473 0x833 0x863 0xa3df 0x897 0x996 0xa358 0x8c5 0xac9 0xa2e6 0x8f3 0xbfc 0xa278 0x919 0xd2e 0xa20a 0x928 0xe61 0xa19f 0x94b 0xf94 0xa137 0x979 0x10c7 0xa0c8 0x979 0x11fa 0xa05e 0x984 0x132c 0x9ffc 0x9a3 0x145f 0x9f9e 0x9c2 0x1592 0x9f44 0x9e2 0x16c5 0x9ef9 0xa11 0x17f7 0x9e9f 0xa30 0x192a 0x9e37 0xa3f 0x1a5d 0x9db9 0xa5c 0x1b90 0x9d3b 0xa7b 0x1cc2 0x9cc7 0xa99 0x1df5 0x9c65 0xaae 0x1f28 0x9c0f 0xabe 0x205b 0x9bcb 0xaeb 0x218d 0x9b87 0xb0f 0x22c0 0x9b43 0xb1e 0x23f3 0x9af5 0xb22 0x2526 0x9aa5 0xb20 0x2659 0x9a4f 0xb11 0x278b 0x99f3 0xaf2 0x28be 0x9991 0xac4 0x29f1 0x9924 0xa6e 0x2b24 0x98b6 0xa15 0x2c56 0x984c 0x9c7 0x2d89 0x97eb 0x98d 0x2ebc 0x978f 0x95f 0x2fef 0x973f 0x931 0x3121 0x96f7 0x91b 0x3254 0x96b9 0x92a 0x3387 0x9680 0x92e 0x34ba 0x964a 0x930 0x35ed 0x9618 0x940 0x371f 0x95e6 0x94f 0x3852 0x95b5 0x95e 0x3985 0x958f 0x989 0x3ab8 0x9569 0x9af 0x3bea 0x953e 0x9be 0x3d1d 0x9513 0x9c4 0x3e50 0x94e8 0x9c4 0x3f83 0x94c9 0x9f3 0x40b5 0x94a7 0xa15 0x41e8 0x9482 0xa25 0x431b 0x9462 0xa34 0x444e 0x9443 0xa48 0x4581 0x9425 0xa76 0x46b3 0x9409 0xa94 0x47e6 0x93f1 0xaa3 0x4919 0x93c7 0xaa5 0x4a4c 0x939d 0xaa1 0x4b7e 0x9378 0xa91 0x4cb1 0x9358 0xaa0 0x4de4 0x9339 0xabe 0x4f17 0x9314 0xace 0x5049 0x92ea 0xad7 0x517c 0x92b9 0xad7 0x52af 0x927f 0xad7 0x53e2 0x923f 0xad9 0x5515 0x91f4 0xae9 0x5647 0x91a0 0xae8 0x577a 0x9144 0xad8 0x58ad 0x90f3 0xad7 0x59e0 0x90af 0xad3 0x5b12 0x908b 0xac3 0x5c45 0x9072 0xaf0 0x5d78 0x9060 0xb3e 0x5eab 0x9053 0xbb9 0x5fdd 0x9042 0xc5a 0x6110 0x9029 0xd35 0x6243 0x8fc2 0xe19 0x6376 0x8f13 0xecb 0x64a8 0x8d5f 0xe7e 0x65db 0x8b73 0xe3a 0x670e 0x8957 0xdfd 0x6841 0x88a0 0xf0e 0x6974 0x880f 0x109f 0x6aa6 0x8782 0x1323 0x6bd9 0x8603 0x15ed 0x6d0c 0x83e1 0x1979 0x6e3f 0x7f66 0x284b 0x6f71 0x7652 0x17d4 0x70a4 0x7652 0x17d4 0x71d7 0x7652 0x17d4 0x730a 0x7652 0x17d4 0x743c 0x7652 0x17d4 0x756f 0x7652 0x17d4 0x76a2 0x7652 0x17d4>;
		battery0_profile_t3_num = <0x64>;
		battery0_profile_t3 = <0x00 0xa9a6 0x721 0x133 0xa925 0x721 0x266 0xa8a9 0x72c 0x398 0xa834 0x74b 0x4cb 0xa7bb 0x75e 0x5fe 0xa73f 0x76f 0x731 0xa6b5 0x78f 0x863 0xa614 0x7a6 0x996 0xa55c 0x7b5 0xac9 0xa468 0x867 0xbfc 0xa377 0x969 0xd2e 0xa2a7 0xb16 0xe61 0xa1f5 0xc81 0xf94 0xa155 0xdc3 0x10c7 0xa0d1 0xe51 0x11fa 0xa056 0xeb8 0x132c 0x9fe8 0xee6 0x145f 0x9f8c 0xf14 0x1592 0x9f37 0xf46 0x16c5 0x9ee7 0xf93 0x17f7 0x9e7c 0xfb9 0x192a 0x9df5 0xfb9 0x1a5d 0x9d66 0xfe2 0x1b90 0x9cdc 0x1008 0x1cc2 0x9c61 0x1018 0x1df5 0x9bfe 0x103b 0x1f28 0x9ba9 0x1069 0x205b 0x9b65 0x1087 0x218d 0x9b1f 0x109a 0x22c0 0x9ad6 0x109a 0x23f3 0x9a86 0x108e 0x2526 0x9a32 0x107a 0x2659 0x99d0 0x104c 0x278b 0x996e 0x101d 0x28be 0x990c 0xfef 0x29f1 0x98a4 0xfb4 0x2b24 0x983f 0xf7f 0x2c56 0x97e3 0xf60 0x2d89 0x978e 0xf4b 0x2ebc 0x973d 0xf3d 0x2fef 0x96f9 0xf4c 0x3121 0x96bb 0xf5b 0x3254 0x9684 0xf6b 0x3387 0x9651 0xf92 0x34ba 0x9620 0xfbe 0x35ed 0x95ef 0xfdc 0x371f 0x95be 0xffb 0x3852 0x958d 0x101a 0x3985 0x9567 0x1038 0x3ab8 0x9540 0x105b 0x3bea 0x9515 0x108a 0x3d1d 0x94e9 0x10af 0x3e50 0x94bf 0x10cd 0x3f83 0x949a 0x10ec 0x40b5 0x9475 0x1111 0x41e8 0x9450 0x113f 0x431b 0x9430 0x116d 0x444e 0x940f 0x1196 0x4581 0x93e4 0x11a6 0x46b3 0x93bf 0x11c6 0x47e6 0x93a0 0x11f4 0x4919 0x9376 0x1206 0x4a4c 0x934b 0x1223 0x4b7e 0x9321 0x1260 0x4cb1 0x92ed 0x1289 0x4de4 0x92b6 0x12a9 0x4f17 0x927e 0x12d7 0x5049 0x9243 0x130d 0x517c 0x9206 0x134a 0x52af 0x91ba 0x1356 0x53e2 0x916d 0x135e 0x5515 0x9130 0x138c 0x5647 0x90fd 0x13cb 0x577a 0x90d2 0x1418 0x58ad 0x90b1 0x149f 0x59e0 0x9094 0x1548 0x5b12 0x907c 0x162e 0x5c45 0x905f 0x175e 0x5d78 0x903c 0x18af 0x5eab 0x8fda 0x19f1 0x5fdd 0x8f26 0x1ade 0x6110 0x8e06 0x1b58 0x6243 0x8c3c 0x1b26 0x6376 0x8a5f 0x1af7 0x64a8 0x88e3 0x1b81 0x65db 0x87da 0x1d9e 0x670e 0x8728 0x20ea 0x6841 0x8528 0x2581 0x6974 0x823a 0x2b52 0x6aa6 0x7c70 0x261e 0x6bd9 0x78b4 0x1ccf 0x6d0c 0x78b4 0x1ccf 0x6e3f 0x78b4 0x1ccf 0x6f71 0x78b4 0x1ccf 0x70a4 0x78b4 0x1ccf 0x71d7 0x78b4 0x1ccf 0x730a 0x78b4 0x1ccf 0x743c 0x78b4 0x1ccf 0x756f 0x78b4 0x1ccf 0x76a2 0x78b4 0x1ccf>;
		battery0_profile_t4_num = <0x64>;
		battery0_profile_t4 = <0x00 0xa956 0xbb8 0x133 0xa8cf 0xbb8 0x266 0xa84d 0xbc3 0x398 0xa7d2 0xbe2 0x4cb 0xa75a 0xbf6 0x5fe 0xa6e4 0xc03 0x731 0xa676 0xc03 0x863 0xa60a 0xc13 0x996 0xa5a2 0xc31 0xac9 0xa53a 0xc5e 0xbfc 0xa4d0 0xc84 0xd2e 0xa462 0xc93 0xe61 0xa3f2 0xcad 0xf94 0xa381 0xccb 0x10c7 0xa313 0xcdb 0x11fa 0xa2ae 0xd15 0x132c 0xa258 0xd8f 0x145f 0xa1e1 0xe16 0x1592 0xa151 0xeae 0x16c5 0xa05b 0xfa4 0x17f7 0x9f66 0x1182 0x192a 0x9e72 0x1442 0x1a5d 0x9da4 0x1694 0x1b90 0x9ce0 0x18a7 0x1cc2 0x9c2e 0x1a36 0x1df5 0x9ba4 0x1b12 0x1f28 0x9b30 0x1b8b 0x205b 0x9ad4 0x1bb9 0x218d 0x9a7c 0x1bfa 0x22c0 0x9a2b 0x1c57 0x23f3 0x99d1 0x1c77 0x2526 0x9973 0x1c7f 0x2659 0x990b 0x1c60 0x278b 0x98a6 0x1c52 0x28be 0x9844 0x1c52 0x29f1 0x97ec 0x1c60 0x2b24 0x9798 0x1c6f 0x2c56 0x9748 0x1c7f 0x2d89 0x9708 0x1cac 0x2ebc 0x96cf 0x1ce9 0x2fef 0x9692 0x1d08 0x3121 0x9657 0x1d3a 0x3254 0x9620 0x1d87 0x3387 0x95f2 0x1dd3 0x34ba 0x95c6 0x1e1e 0x35ed 0x9595 0x1e5b 0x371f 0x9564 0x1ea9 0x3852 0x9532 0x1f07 0x3985 0x9506 0x1f55 0x3ab8 0x94d9 0x1fa2 0x3bea 0x94a8 0x1fef 0x3d1d 0x947b 0x2046 0x3e50 0x9450 0x20a1 0x3f83 0x9412 0x20ee 0x40b5 0x93d7 0x2141 0x41e8 0x939f 0x219f 0x431b 0x9362 0x21fc 0x444e 0x9324 0x2255 0x4581 0x92e0 0x22a2 0x46b3 0x92a0 0x2308 0x47e6 0x9263 0x2382 0x4919 0x9220 0x23e1 0x4a4c 0x91de 0x2459 0x4b7e 0x919f 0x2515 0x4cb1 0x9161 0x25ee 0x4de4 0x9124 0x26d5 0x4f17 0x90ed 0x27ca 0x5049 0x90b6 0x28da 0x517c 0x907f 0x2a0d 0x52af 0x9039 0x2b4c 0x53e2 0x8fe3 0x2c8d 0x5515 0x8f53 0x2dc6 0x5647 0x8e81 0x2ea3 0x577a 0x8d7f 0x2f3c 0x58ad 0x8be1 0x2f53 0x59e0 0x8a33 0x2fba 0x5b12 0x887a 0x30dd 0x5c45 0x86cd 0x3465 0x5d78 0x8513 0x389f 0x5eab 0x8193 0x32bf 0x5fdd 0x7ca6 0x2742 0x6110 0x7ca6 0x2742 0x6243 0x7ca6 0x2742 0x6376 0x7ca6 0x2742 0x64a8 0x7ca6 0x2742 0x65db 0x7ca6 0x2742 0x670e 0x7ca6 0x2742 0x6841 0x7ca6 0x2742 0x6974 0x7ca6 0x2742 0x6aa6 0x7ca6 0x2742 0x6bd9 0x7ca6 0x2742 0x6d0c 0x7ca6 0x2742 0x6e3f 0x7ca6 0x2742 0x6f71 0x7ca6 0x2742 0x70a4 0x7ca6 0x2742 0x71d7 0x7ca6 0x2742 0x730a 0x7ca6 0x2742 0x743c 0x7ca6 0x2742 0x756f 0x7ca6 0x2742 0x76a2 0x7ca6 0x2742>;
		linux,phandle = <0x7c>;
		phandle = <0x7c>;
	};

	mdp_rdma0@14001000 {
		compatible = "mediatek,mdp_rdma0";
		reg = <0x00 0x14001000 0x00 0x1000>;
		interrupts = <0x00 0xda 0x08>;
		clocks = <0x2c 0x0d>;
		clock-names = "MDP_RDMA0";
		linux,phandle = <0x2e>;
		phandle = <0x2e>;
	};

	mdp_rdma1@14002000 {
		compatible = "mediatek,mdp_rdma1";
		reg = <0x00 0x14002000 0x00 0x1000>;
		interrupts = <0x00 0xdb 0x08>;
		linux,phandle = <0x2f>;
		phandle = <0x2f>;
	};

	mdp_rsz0@14003000 {
		compatible = "mediatek,mdp_rsz0";
		reg = <0x00 0x14003000 0x00 0x1000>;
		interrupts = <0x00 0xdc 0x08>;
		clocks = <0x2c 0x0f>;
		clock-names = "MDP_RSZ0";
		linux,phandle = <0x30>;
		phandle = <0x30>;
	};

	mdp_rsz1@14004000 {
		compatible = "mediatek,mdp_rsz1";
		reg = <0x00 0x14004000 0x00 0x1000>;
		interrupts = <0x00 0xdd 0x08>;
		clocks = <0x2c 0x10>;
		clock-names = "MDP_RSZ1";
		linux,phandle = <0x31>;
		phandle = <0x31>;
	};

	mdp_wrot0@14005000 {
		compatible = "mediatek,mdp_wrot0";
		reg = <0x00 0x14005000 0x00 0x1000>;
		interrupts = <0x00 0xdf 0x08>;
		clocks = <0x2c 0x12>;
		clock-names = "MDP_WROT0";
		linux,phandle = <0x32>;
		phandle = <0x32>;
	};

	mdp_wdma@14006000 {
		compatible = "mediatek,mdp_wdma";
		reg = <0x00 0x14006000 0x00 0x1000>;
		interrupts = <0x00 0xe0 0x08>;
		clocks = <0x2c 0x2a>;
		clock-names = "MDP_WDMA";
		linux,phandle = <0x33>;
		phandle = <0x33>;
	};

	mdp_tdshp@14007000 {
		compatible = "mediatek,mdp_tdshp";
		reg = <0x00 0x14007000 0x00 0x1000>;
		interrupts = <0x00 0xde 0x08>;
		clocks = <0x2c 0x11>;
		clock-names = "MDP_TDSHP";
		linux,phandle = <0x34>;
		phandle = <0x34>;
	};

	mtkfb@0 {
		compatible = "mediatek,mtkfb";
		linux,phandle = <0x7d>;
		phandle = <0x7d>;
	};

	dispsys {
		compatible = "mediatek,dispsys";
		clocks = <0x2b 0x03 0x2c 0x01 0x2c 0x02 0x2c 0x03 0x2c 0x04 0x2c 0x05 0x2c 0x14 0x2c 0x15 0x2c 0x16 0x2c 0x17 0x2c 0x18 0x2c 0x19 0x2c 0x1a 0x2c 0x1b 0x2c 0x1c 0x2c 0x1d 0x2c 0x1e 0x2c 0x20 0x2c 0x21 0x2c 0x22 0x2c 0x23 0x2c 0x2d 0x2c 0x2e 0x2c 0x27 0x2c 0x29 0x3f 0x02 0x3f 0x16 0x15 0x36 0x3d 0x3f 0x43 0x3f 0x44 0x3f 0x5c 0x3f 0x5d 0x3f 0x5f 0x3f 0x12 0x3f 0x52 0x3f 0x53 0x3f 0x54 0x3f 0x55 0x3f 0x51>;
		clock-names = "MMSYS_MTCMOS\0MMSYS_SMI_COMMON\0MMSYS_SMI_LARB0\0MMSYS_SMI_LARB1\0MMSYS_GALS_COMM0\0MMSYS_GALS_COMM1\0MMSYS_DISP_OVL0\0MMSYS_DISP_OVL0_2L\0MMSYS_DISP_OVL1_2L\0MMSYS_DISP_RDMA0\0MMSYS_DISP_RDMA1\0MMSYS_DISP_WDMA0\0MMSYS_DISP_COLOR0\0MMSYS_DISP_CCORR0\0MMSYS_DISP_AAL0\0MMSYS_DISP_GAMMA0\0MMSYS_DISP_DITHER0\0MMSYS_DSI0_MM_CK\0MMSYS_DSI0_IF_CK\0MMSYS_DPI_MM_CK\0MMSYS_DPI_IF_CK\0MMSYS_DBI_MM_CK\0MMSYS_DBI_IF_CK\0MMSYS_26M\0MMSYS_DISP_RSZ\0TOP_MUX_MM\0TOP_MUX_DISP_PWM\0DISP_PWM\0TOP_26M\0TOP_UNIVPLL_D3_D2\0TOP_UNIVPLL_D3_D4\0TOP_OSC_D2\0TOP_OSC_D4\0TOP_OSC_D16\0MUX_DPI0\0TVDPLL_D2\0TVDPLL_D4\0TVDPLL_D8\0TVDPLL_D16\0DPI_CK";
	};

	dsi_te {
		compatible = "mediatek, DSI_TE-eint";
		status = "disabled";
		linux,phandle = <0x7e>;
		phandle = <0x7e>;
	};

	mhl@0 {
		compatible = "mediatek,extd_dev";
		linux,phandle = <0x7f>;
		phandle = <0x7f>;
	};

	disp_ovl0@14008000 {
		compatible = "mediatek,disp_ovl0";
		reg = <0x00 0x14008000 0x00 0x1000>;
		interrupts = <0x00 0xe1 0x08>;
	};

	disp_ovl0_2l@14009000 {
		compatible = "mediatek,disp_ovl0_2l";
		reg = <0x00 0x14009000 0x00 0x1000>;
		interrupts = <0x00 0xe2 0x08>;
	};

	disp_ovl1_2l@1400a000 {
		compatible = "mediatek,disp_ovl1_2l";
		reg = <0x00 0x1400a000 0x00 0x1000>;
		interrupts = <0x00 0xe3 0x08>;
	};

	disp_rdma0@1400b000 {
		compatible = "mediatek,disp_rdma0";
		reg = <0x00 0x1400b000 0x00 0x1000>;
		interrupts = <0x00 0xe4 0x08>;
	};

	disp_rdma1@1400c000 {
		compatible = "mediatek,disp_rdma1";
		reg = <0x00 0x1400c000 0x00 0x1000>;
		interrupts = <0x00 0xe5 0x08>;
	};

	disp_wdma0@1400d000 {
		compatible = "mediatek,disp_wdma0";
		reg = <0x00 0x1400d000 0x00 0x1000>;
		interrupts = <0x00 0xe6 0x08>;
	};

	disp_color0@1400e000 {
		compatible = "mediatek,disp_color0";
		reg = <0x00 0x1400e000 0x00 0x1000>;
		interrupts = <0x00 0xe7 0x08>;
		clocks = <0x2c 0x1a>;
		clock-names = "MDP_COLOR";
		linux,phandle = <0x37>;
		phandle = <0x37>;
	};

	disp_ccorr0@1400f000 {
		compatible = "mediatek,disp_ccorr0";
		reg = <0x00 0x1400f000 0x00 0x1000>;
		interrupts = <0x00 0xe8 0x08>;
	};

	disp_aal0@14010000 {
		compatible = "mediatek,disp_aal0";
		reg = <0x00 0x14010000 0x00 0x1000>;
		interrupts = <0x00 0xe9 0x08>;
		aal_support = <0x01>;
		linux,phandle = <0x80>;
		phandle = <0x80>;
	};

	disp_gamma0@14011000 {
		compatible = "mediatek,disp_gamma0";
		reg = <0x00 0x14011000 0x00 0x1000>;
		interrupts = <0x00 0xea 0x08>;
	};

	disp_dither0@14012000 {
		compatible = "mediatek,disp_dither0";
		reg = <0x00 0x14012000 0x00 0x1000>;
		interrupts = <0x00 0xeb 0x08>;
	};

	disp_split@14013000 {
		compatible = "mediatek,disp_split";
		reg = <0x00 0x14013000 0x00 0x1000>;
	};

	dsi0@14014000 {
		compatible = "mediatek,dsi0";
		reg = <0x00 0x14014000 0x00 0x1000>;
		interrupts = <0x00 0xec 0x08>;
	};

	dpi0@14015000 {
		compatible = "mediatek,dpi0";
		reg = <0x00 0x14015000 0x00 0x1000>;
		interrupts = <0x00 0xed 0x08>;
	};

	disp_mutex@14016000 {
		compatible = "mediatek,disp_mutex";
		reg = <0x00 0x14016000 0x00 0x1000>;
		interrupts = <0x00 0xd9 0x08>;
		linux,phandle = <0x2d>;
		phandle = <0x2d>;
	};

	smi_larb0@14017000 {
		compatible = "mediatek,smi_larb0";
		reg = <0x00 0x14017000 0x00 0x1000>;
		interrupts = <0x00 0xf0 0x08>;
		clocks = <0x2b 0x03 0x2c 0x02>;
		clock-names = "mtcmos-mm\0mm-larb0";
		linux,phandle = <0x3c>;
		phandle = <0x3c>;
	};

	smi_common@14019000 {
		compatible = "mediatek,smi_common";
		reg = <0x00 0x14019000 0x00 0x1000>;
		larbs = <0x3c 0x41 0x42 0x43 0x44 0x45 0x46>;
		mmsys_config = <0x2c>;
		clocks = <0x2b 0x03 0x2c 0x04 0x2c 0x05 0x2c 0x01 0x3f 0x02 0x3f 0x03 0x3f 0x23 0x3f 0x2c 0x3f 0x2d 0x3f 0x6f 0x3f 0x70 0x3f 0x40>;
		clock-names = "mtcmos-mm\0smi-common-gals-comm0\0smi-common-gals-comm1\0smi-common\0MMDVFS_CLK_MUX_TOP_MM_SEL\0MMDVFS_CLK_MUX_TOP_CAM_SEL\0MMDVFS_CLK_MUX_TOP_IMG_SEL\0mmdvfs_clk_syspll_d2_ck\0mmdvfs_clk_syspll_d3_ck\0mmdvfs_clk_mmpll_d6_ck\0mmdvfs_clk_mmpll_d7_ck\0mmdvfs_clk_univpll_d2_d2_ck";
	};

	mmdvfs_pmqos {
		compatible = "mediatek,mmdvfs_pmqos";
		mm_step0 = <0x1c2 0x01 0x00 0x06>;
		mm_step1 = <0x138 0x01 0x00 0x07>;
		cam_step0 = <0x222 0x01 0x01 0x03>;
		cam_step1 = <0x16c 0x01 0x01 0x04>;
		img_step0 = <0x20d 0x01 0x02 0x05>;
		img_step1 = <0x16c 0x01 0x02 0x04>;
		vopp_steps = <0x00 0x01>;
		disp_freq = "mm_step0\0mm_step1";
		mdp_freq = "mm_step0\0mm_step1";
		cam_freq = "cam_step0\0cam_step1";
		img_freq = "img_step0\0img_step1";
		vdec_freq = "mm_step0\0mm_step1";
		venc_freq = "mm_step0\0mm_step1";
		clocks = <0x3f 0x02 0x3f 0x03 0x3f 0x23 0x3f 0x2c 0x3f 0x2d 0x3f 0x6f 0x3f 0x70 0x3f 0x40>;
		clock-names = "mmdvfs_clk_mux_top_mm_sel\0mmdvfs_clk_mux_top_cam_sel\0mmdvfs_clk_mux_top_img_sel\0mmdvfs_clk_syspll_d2_ck\0mmdvfs_clk_syspll_d3_ck\0mmdvfs_clk_mmpll_d6_ck\0mmdvfs_clk_mmpll_d7_ck\0mmdvfs_clk_univpll_d2_d2_ck";
	};

	disp_rsz@1401a000 {
		compatible = "mediatek,disp_rsz";
		reg = <0x00 0x1401a000 0x00 0x1000>;
		interrupts = <0x00 0xf1 0x08>;
	};

	mdp_aal@1401b000 {
		compatible = "mediatek,mdp_aal";
		reg = <0x00 0x1401b000 0x00 0x1000>;
		interrupts = <0x00 0xf2 0x08>;
		clocks = <0x2c 0x2b>;
		clock-names = "MDP_AAL";
		linux,phandle = <0x35>;
		phandle = <0x35>;
	};

	mdp_ccorr@1401c000 {
		compatible = "mediatek,mdp_ccorr";
		reg = <0x00 0x1401c000 0x00 0x1000>;
		interrupts = <0x00 0xf3 0x08>;
		clocks = <0x2c 0x2c>;
		clock-names = "MDP_CCORR";
		linux,phandle = <0x36>;
		phandle = <0x36>;
	};

	dbi@1401d000 {
		compatible = "mediatek,dbi";
		reg = <0x00 0x1401d000 0x00 0x1000>;
		interrupts = <0x00 0xf4 0x08>;
	};

	i2c@1401e000 {
		compatible = "mediatek,i2c";
		reg = <0x00 0x1401e000 0x00 0x1000>;
	};

	dsi1@1401f000 {
		compatible = "mediatek,dsi1";
		reg = <0x00 0x1401f000 0x00 0x1000>;
	};

	mdp_wrot1@14020000 {
		compatible = "mediatek,mdp_wrot1";
		reg = <0x00 0x14020000 0x00 0x1000>;
	};

	vdec_gcon@16000000 {
		compatible = "mediatek,vdec_gcon\0syscon";
		reg = <0x00 0x16000000 0x00 0x1000>;
		clocks = <0x2b 0x03 0x2b 0x0d 0x2b 0x06 0x47 0x01 0x48 0x02>;
		clock-names = "MT_SCP_SYS_DIS\0MT_SCP_SYS_VDE\0MT_SCP_SYS_VEN\0MT_CG_VDEC\0MT_CG_VENC";
		#clock-cells = <0x01>;
		linux,phandle = <0x47>;
		phandle = <0x47>;
	};

	smi_larb1@16010000 {
		compatible = "mediatek,smi_larb1";
		reg = <0x00 0x16010000 0x00 0x1000>;
		interrupts = <0x00 0x127 0x08>;
		clocks = <0x2b 0x0d 0x47 0x01 0x47 0x02>;
		clock-names = "mtcmos-vde\0vdec-vdec\0vdec-larb1";
		linux,phandle = <0x41>;
		phandle = <0x41>;
	};

	vdec@16020000 {
		compatible = "mediatek,vdec";
		reg = <0x00 0x16020000 0x00 0x10000>;
		interrupts = <0x00 0xfa 0x08>;
	};

	vdtop@16020000 {
		compatible = "mediatek,vdtop";
		reg = <0x00 0x16020000 0x00 0x1000>;
	};

	vld@16021000 {
		compatible = "mediatek,vld";
		reg = <0x00 0x16021000 0x00 0x1000>;
	};

	vld_top@16021800 {
		compatible = "mediatek,vld_top";
		reg = <0x00 0x16021800 0x00 0x1000>;
	};

	mc@16022000 {
		compatible = "mediatek,mc";
		reg = <0x00 0x16022000 0x00 0x1000>;
	};

	avc_vld@16023000 {
		compatible = "mediatek,avc_vld";
		reg = <0x00 0x16023000 0x00 0x1000>;
	};

	avc_mv@16024000 {
		compatible = "mediatek,avc_mv";
		reg = <0x00 0x16024000 0x00 0x1000>;
	};

	vdec_pp@16025000 {
		compatible = "mediatek,vdec_pp";
		reg = <0x00 0x16025000 0x00 0x1000>;
	};

	hevc_vld@16028000 {
		compatible = "mediatek,hevc_vld";
		reg = <0x00 0x16028000 0x00 0x1000>;
	};

	vp8_vld@16026800 {
		compatible = "mediatek,vp8_vld";
		reg = <0x00 0x16026800 0x00 0x1000>;
	};

	vp6@16027000 {
		compatible = "mediatek,vp6";
		reg = <0x00 0x16027000 0x00 0x1000>;
	};

	vld2@16027800 {
		compatible = "mediatek,vld2";
		reg = <0x00 0x16027800 0x00 0x1000>;
	};

	mc_vmmu@16028000 {
		compatible = "mediatek,mc_vmmu";
		reg = <0x00 0x16028000 0x00 0x1000>;
	};

	pp_vmmu@16029000 {
		compatible = "mediatek,pp_vmmu";
		reg = <0x00 0x16029000 0x00 0x1000>;
	};

	venc_gcon@17000000 {
		compatible = "mediatek,venc_gcon\0syscon";
		reg = <0x00 0x17000000 0x00 0x1000>;
		#clock-cells = <0x01>;
		linux,phandle = <0x48>;
		phandle = <0x48>;
	};

	smi_larb4@17010000 {
		compatible = "mediatek,smi_larb4";
		reg = <0x00 0x17010000 0x00 0x1000>;
		interrupts = <0x00 0xf8 0x08>;
		clocks = <0x2b 0x06 0x48 0x01 0x48 0x02 0x48 0x03>;
		clock-names = "mtcmos-ven\0venc-larb4\0venc-venc\0venc-jpgenc";
		linux,phandle = <0x44>;
		phandle = <0x44>;
	};

	venc@17020000 {
		compatible = "mediatek,venc";
		reg = <0x00 0x17020000 0x00 0x1000>;
		interrupts = <0x00 0xf7 0x08>;
		linux,phandle = <0x38>;
		phandle = <0x38>;
	};

	venc_jpg@17030000 {
		compatible = "mediatek,venc_jpg";
		reg = <0x00 0x17030000 0x00 0x1000>;
		interrupts = <0x00 0xf9 0x08>;
		clocks = <0x48 0x03>;
		clock-names = "MT_CG_VENC_JPGENC";
	};

	mbist@17040000 {
		compatible = "mediatek,mbist";
		reg = <0x00 0x17040000 0x00 0x1000>;
	};

	mjc_config@12000000 {
		compatible = "mediatek,mjc_config";
		reg = <0x00 0x12000000 0x00 0x1000>;
	};

	mjc_top@12001000 {
		compatible = "mediatek,mjc_top";
		reg = <0x00 0x12001000 0x00 0x1000>;
	};

	imgsys1_dfp@1502e000 {
		compatible = "mediatek,imgsys1_dfp";
		reg = <0x00 0x1502e000 0x00 0x1000>;
	};

	imgsys@15020000 {
		compatible = "mediatek,imgsys\0syscon";
		reg = <0x00 0x15020000 0x00 0x1000>;
		#clock-cells = <0x01>;
		clocks = <0x49 0x0a 0x49 0x08>;
		clock-names = "DIP_CG_IMG_LARB5\0DIP_CG_IMG_DIP";
		linux,phandle = <0x49>;
		phandle = <0x49>;
	};

	imgsyscq@15020000 {
		compatible = "mediatek,imgsyscq";
		reg = <0x00 0x15020000 0x00 0x10>;
	};

	smi_larb2@1502f000 {
		compatible = "mediatek,smi_larb2";
		reg = <0x00 0x1502f000 0x00 0x1000>;
		interrupts = <0x00 0x107 0x08>;
		clocks = <0x2b 0x05 0x2c 0x0a 0x49 0x09>;
		clock-names = "mtcmos-isp\0gals-ipu2mm\0img-larb2";
		linux,phandle = <0x42>;
		phandle = <0x42>;
	};

	smi_larb5@15021000 {
		compatible = "mediatek,smi_larb5";
		reg = <0x00 0x15021000 0x00 0x1000>;
		interrupts = <0x00 0x10b 0x08>;
		clocks = <0x2b 0x05 0x2c 0x08 0x49 0x0a>;
		clock-names = "mtcmos-isp\0gals-img2mm\0img-larb5";
		linux,phandle = <0x45>;
		phandle = <0x45>;
	};

	dip1@15022000 {
		compatible = "mediatek,dip1";
		reg = <0x00 0x15022000 0x00 0x6000>;
		interrupts = <0x00 0x10c 0x08>;
	};

	dip2@15023000 {
		compatible = "mediatek,dip2";
		reg = <0x00 0x15023000 0x00 0x1000>;
	};

	dip3@15024000 {
		compatible = "mediatek,dip3";
		reg = <0x00 0x15024000 0x00 0x1000>;
	};

	dip4@15025000 {
		compatible = "mediatek,dip4";
		reg = <0x00 0x15025000 0x00 0x1000>;
	};

	dip5@15026000 {
		compatible = "mediatek,dip5";
		reg = <0x00 0x15026000 0x00 0x1000>;
	};

	dip6@15027000 {
		compatible = "mediatek,dip6";
		reg = <0x00 0x15027000 0x00 0x1000>;
	};

	dpe@15028000 {
		compatible = "mediatek,dpe";
		reg = <0x00 0x15028000 0x00 0x1000>;
		interrupts = <0x00 0x10e 0x08>;
		clocks = <0x49 0x06>;
		clock-names = "DPE_CG_IMG_DPE";
	};

	dpe_dma@15028000 {
		compatible = "mediatek,dpe_dma";
		reg = <0x00 0x15028000 0x00 0x1000>;
	};

	rsc@15029000 {
		compatible = "mediatek,rsc";
		reg = <0x00 0x15029000 0x00 0x1000>;
		interrupts = <0x00 0x10f 0x08>;
		clocks = <0x49 0x05>;
		clock-names = "RSC_CLK_IMG_RSC";
	};

	wpe_a@1502a000 {
		compatible = "mediatek,wpe_a";
		reg = <0x00 0x1502a000 0x00 0x1000>;
		interrupts = <0x00 0x111 0x08>;
		clocks = <0x49 0x03>;
		clock-names = "WPE_CLK_IMG_WPE_A";
	};

	wpe_b@1502d000 {
		compatible = "mediatek,wpe_b";
		reg = <0x00 0x1502d000 0x00 0x1000>;
		interrupts = <0x00 0x112 0x08>;
		clocks = <0x49 0x02>;
		clock-names = "WPE_CLK_IMG_WPE_B";
	};

	fdvt@1502b000 {
		compatible = "mediatek,fdvt";
		reg = <0x00 0x1502b000 0x00 0x1000>;
		interrupts = <0x00 0x10d 0x08>;
		clocks = <0x49 0x07>;
		clock-names = "FD_CLK_IMG_FDVT";
	};

	fdvt_dma@1502b000 {
		compatible = "mediatek,fdvt_dma";
		reg = <0x00 0x1502b000 0x00 0x1000>;
	};

	mfb@1502e000 {
		compatible = "mediatek,mfb";
		reg = <0x00 0x1502e000 0x00 0x1000>;
		interrupts = <0x00 0x114 0x08>;
		clocks = <0x49 0x04>;
		clock-names = "MFB_CLK_IMG_MFB";
	};

	tsf@1a0a1000 {
		compatible = "mediatek,tsf";
		reg = <0x00 0x1a0a1000 0x00 0x1000>;
		interrupts = <0x00 0x109 0x08>;
		clocks = <0x4a 0x09>;
		clock-names = "TSF_CAMSYS_TSF_CGPDN";
	};

	owe@1502c000 {
		compatible = "mediatek,owe";
		reg = <0x00 0x1502c000 0x00 0x1000>;
		interrupts = <0x00 0x115 0x08>;
		clocks = <0x49 0x01>;
		clock-names = "OWE_CLK_IMG_OWE";
	};

	owe_dma@1502c000 {
		compatible = "mediatek,owe_dma";
		reg = <0x00 0x1502c000 0x00 0x1000>;
	};

	eaf@1502d000 {
		compatible = "mediatek,eaf";
		reg = <0x00 0x1502d000 0x00 0x1000>;
	};

	imgsys1_vad@1502e000 {
		compatible = "mediatek,imgsys1_vad";
		reg = <0x00 0x1502e000 0x00 0x1000>;
	};

	camsys@1a000000 {
		compatible = "mediatek,camsys\0syscon";
		reg = <0x00 0x1a000000 0x00 0x1000>;
		#clock-cells = <0x01>;
		clocks = <0x2b 0x03 0x2b 0x05 0x2b 0x09 0x4a 0x03 0x4a 0x04 0x4a 0x06 0x4a 0x07 0x4a 0x08>;
		clock-names = "ISP_SCP_SYS_DIS\0ISP_SCP_SYS_ISP\0ISP_SCP_SYS_CAM\0CAMSYS_CAM_CGPDN\0CAMSYS_CAMTG_CGPDN\0CAMSYS_CAMSV0_CGPDN\0CAMSYS_CAMSV1_CGPDN\0CAMSYS_CAMSV2_CGPDN";
		linux,phandle = <0x4a>;
		phandle = <0x4a>;
	};

	ipu_conn@19000000 {
		compatible = "mediatek,ipu_conn\0syscon";
		reg = <0x00 0x19000000 0x00 0x1000>;
		#clock-cells = <0x01>;
		linux,phandle = <0x4d>;
		phandle = <0x4d>;
	};

	ipu_adl@19010000 {
		compatible = "mediatek,ipu_adl\0syscon";
		reg = <0x00 0x19010000 0x00 0x1000>;
		#clock-cells = <0x01>;
		linux,phandle = <0x81>;
		phandle = <0x81>;
	};

	ipu0@19180000 {
		compatible = "mediatek,ipu0\0syscon";
		reg = <0x00 0x19180000 0x00 0x1000>;
		interrupts = <0x00 0x124 0x08>;
		#clock-cells = <0x01>;
		linux,phandle = <0x4b>;
		phandle = <0x4b>;
	};

	ipu1@19280000 {
		compatible = "mediatek,ipu1\0syscon";
		reg = <0x00 0x19280000 0x00 0x1000>;
		interrupts = <0x00 0x125 0x08>;
		#clock-cells = <0x01>;
		linux,phandle = <0x4c>;
		phandle = <0x4c>;
	};

	vpu_core0@0x19100000 {
		compatible = "mediatek,vpu_core0";
		reg = <0x00 0x19100000 0x00 0x94000>;
		interrupts = <0x00 0x124 0x08>;
		clocks = <0x3f 0x24 0x3f 0x25 0x3f 0x26 0x3f 0x27 0x4b 0x01 0x4b 0x02 0x4b 0x03 0x4c 0x01 0x4c 0x02 0x4c 0x03 0x4d 0x01 0x4d 0x07 0x4d 0x08 0x4d 0x09 0x4d 0x0a 0x4d 0x0b 0x4d 0x0c 0x4d 0x0d 0x4d 0x0e 0x4d 0x0f 0x4d 0x01 0x4d 0x02 0x4d 0x03 0x4d 0x04 0x4d 0x05 0x4d 0x06 0x3f 0x6f 0x3f 0x70 0x3f 0x3d 0x3f 0x2d 0x3f 0x40 0x3f 0x30 0x3f 0x43 0x3f 0x34 0x2c 0x0a 0x2c 0x07 0x2c 0x05 0x2c 0x04 0x2c 0x01 0x2b 0x03 0x2b 0x0e 0x2b 0x0f 0x2b 0x10 0x2b 0x11 0x2b 0x12>;
		clock-names = "clk_top_dsp_sel\0clk_top_dsp1_sel\0clk_top_dsp2_sel\0clk_top_ipu_if_sel\0clk_ipu_core0_jtag_cg\0clk_ipu_core0_axi_m_cg\0clk_ipu_core0_ipu_cg\0clk_ipu_core1_jtag_cg\0clk_ipu_core1_axi_m_cg\0clk_ipu_core1_ipu_cg\0clk_ipu_adl_cabgen\0clk_ipu_conn_dap_rx_cg\0clk_ipu_conn_apb2axi_cg\0clk_ipu_conn_apb2ahb_cg\0clk_ipu_conn_ipu_cab1to2\0clk_ipu_conn_ipu1_cab1to2\0clk_ipu_conn_ipu2_cab1to2\0clk_ipu_conn_cab3to3\0clk_ipu_conn_cab2to1\0clk_ipu_conn_cab3to1_slice\0clk_ipu_conn_ipu_cg\0clk_ipu_conn_ahb_cg\0clk_ipu_conn_axi_cg\0clk_ipu_conn_isp_cg\0clk_ipu_conn_cam_adl_cg\0clk_ipu_conn_img_adl_cg\0clk_top_mmpll_d6\0clk_top_mmpll_d7\0clk_top_univpll_d3\0clk_top_syspll_d3\0clk_top_univpll_d2_d2\0clk_top_syspll_d2_d2\0clk_top_univpll_d3_d2\0clk_top_syspll_d3_d2\0clk_mmsys_gals_ipu2mm\0clk_mmsys_gals_ipu12mm\0clk_mmsys_gals_comm1\0clk_mmsys_gals_comm0\0clk_mmsys_smi_common\0mtcmos_dis\0mtcmos_vpu_top\0mtcmos_vpu_core0_dormant\0mtcmos_vpu_core0_shutdown\0mtcmos_vpu_core1_dormant\0mtcmos_vpu_core1_shutdown";
	};

	vpu_core1@0x19200000 {
		compatible = "mediatek,vpu_core1";
		reg = <0x00 0x19200000 0x00 0x94000>;
		interrupts = <0x00 0x125 0x08>;
	};

	smi_larb3@1a002000 {
		compatible = "mediatek,smi_larb3";
		reg = <0x00 0x1a002000 0x00 0x1000>;
		clocks = <0x2b 0x09 0x2c 0x07 0x4a 0x0a>;
		clock-names = "mtcmos-cam\0gals-ipu12mm\0cam-larb3";
		linux,phandle = <0x43>;
		phandle = <0x43>;
	};

	smi_larb6@1a001000 {
		compatible = "mediatek,smi_larb6";
		reg = <0x00 0x1a001000 0x00 0x1000>;
		clocks = <0x2b 0x09 0x2c 0x09 0x4a 0x01>;
		clock-names = "mtcmos-cam\0gals-cam2mm\0cam-larb6";
		linux,phandle = <0x46>;
		phandle = <0x46>;
	};

	cam1@1a003000 {
		compatible = "mediatek,cam1";
		reg = <0x00 0x1a003000 0x00 0x1000>;
		interrupts = <0x00 0xfd 0x08>;
	};

	cam2@1a004000 {
		compatible = "mediatek,cam2";
		reg = <0x00 0x1a004000 0x00 0x2000>;
		interrupts = <0x00 0xfe 0x08>;
	};

	cam3@1a006000 {
		compatible = "mediatek,cam3";
		reg = <0x00 0x1a006000 0x00 0x2000>;
		interrupts = <0x00 0xff 0x08>;
	};

	cam4@1a008000 {
		compatible = "mediatek,cam4";
		reg = <0x00 0x1a008000 0x00 0x2000>;
		interrupts = <0x00 0x100 0x08>;
	};

	camsv1@1a050000 {
		compatible = "mediatek,camsv1";
		reg = <0x00 0x1a050000 0x00 0x1000>;
		interrupts = <0x00 0x102 0x08>;
	};

	camsv2@1a051000 {
		compatible = "mediatek,camsv2";
		reg = <0x00 0x1a051000 0x00 0x1000>;
		interrupts = <0x00 0x103 0x08>;
	};

	camsv3@1a052000 {
		compatible = "mediatek,camsv3";
		reg = <0x00 0x1a052000 0x00 0x1000>;
		interrupts = <0x00 0x104 0x08>;
	};

	camsv4@1a053000 {
		compatible = "mediatek,camsv4";
		reg = <0x00 0x1a053000 0x00 0x1000>;
		interrupts = <0x00 0x105 0x08>;
	};

	camsv5@1a054000 {
		compatible = "mediatek,camsv5";
		reg = <0x00 0x1a054000 0x00 0x1000>;
	};

	camsv6@1a055000 {
		compatible = "mediatek,camsv6";
		reg = <0x00 0x1a055000 0x00 0x1000>;
	};

	seninf1@1a040000 {
		compatible = "mediatek,seninf1";
		reg = <0x00 0x1a040000 0x00 0x1000>;
	};

	seninf2@1a041000 {
		compatible = "mediatek,seninf2";
		reg = <0x00 0x1a041000 0x00 0x1000>;
	};

	seninf3@1a042000 {
		compatible = "mediatek,seninf3";
		reg = <0x00 0x1a042000 0x00 0x1000>;
	};

	seninf4@1a043000 {
		compatible = "mediatek,seninf4";
		reg = <0x00 0x1a043000 0x00 0x1000>;
	};

	seninf5@1a044000 {
		compatible = "mediatek,seninf5";
		reg = <0x00 0x1a044000 0x00 0x1000>;
	};

	seninf6@1a045000 {
		compatible = "mediatek,seninf6";
		reg = <0x00 0x1a045000 0x00 0x1000>;
	};

	seninf7@1a046000 {
		compatible = "mediatek,seninf7";
		reg = <0x00 0x1a046000 0x00 0x1000>;
	};

	seninf8@1a047000 {
		compatible = "mediatek,seninf8";
		reg = <0x00 0x1a047000 0x00 0x1000>;
	};

	seninf_top@1a040000 {
		compatible = "mediatek,seninf_top";
		reg = <0x00 0x1a040000 0x00 0x1000>;
		clocks = <0x2b 0x03 0x2b 0x09 0x4a 0x05 0x3f 0x1c 0x3f 0x05 0x3f 0x1e 0x3f 0x28 0x3f 0x29 0x3d 0x3f 0x65 0x3f 0x45 0x3f 0x64 0x3f 0x60 0x3f 0x66 0x3f 0x67>;
		clock-names = "SCP_SYS_DIS\0SCP_SYS_CAM\0CAMSYS_SENINF_CGPDN\0TOP_MUX_SENINF\0TOP_MUX_CAMTG\0TOP_MUX_CAMTG2\0TOP_MUX_CAMTG3\0TOP_MUX_CAMTG4\0TOP_CLK26M\0TOP_UNIVP_192M_D8\0TOP_UNIVPLL_D3_D8\0TOP_UNIVP_192M_D4\0TOP_F26M_CK_D2\0TOP_UNIVP_192M_D16\0TOP_UNIVP_192M_D32";
	};

	kd_camera_hw1@1a040000 {
		compatible = "mediatek,imgsensor";
		linux,phandle = <0x82>;
		phandle = <0x82>;
	};

	flashlight_core {
		compatible = "mediatek,flashlight_core";
		linux,phandle = <0x83>;
		phandle = <0x83>;
	};

	flashlights_lm3642 {
		compatible = "mediatek,flashlights_lm3642";
		decouple = <0x01>;
		linux,phandle = <0x84>;
		phandle = <0x84>;

		channel@1 {
			type = <0x01>;
			ct = <0x00>;
			part = <0x00>;
		};
	};

	flashlights_ha7109 {
		compatible = "mediatek,flashlights_ha7109";
		decouple = <0x01>;
		linux,phandle = <0x85>;
		phandle = <0x85>;

		channel@1 {
			type = <0x01>;
			ct = <0x01>;
			part = <0x00>;
		};
	};

	flashlights_mt6370 {
		compatible = "mediatek,flashlights_mt6370";
		decouple = <0x00>;
		linux,phandle = <0x86>;
		phandle = <0x86>;

		channel@1 {
			type = <0x00>;
			ct = <0x00>;
			part = <0x00>;
		};

		channel@2 {
			type = <0x00>;
			ct = <0x01>;
			part = <0x00>;
		};
	};

	flashlights_rt4509 {
		compatible = "mediatek,flashlights_rt4509";
		decouple = <0x01>;
		linux,phandle = <0x87>;
		phandle = <0x87>;

		channel@1 {
			type = <0x01>;
			ct = <0x00>;
			part = <0x00>;
		};

		channel@2 {
			type = <0x01>;
			ct = <0x01>;
			part = <0x00>;
		};
	};

	flashlights_lm3643 {
		compatible = "mediatek,flashlights_lm3643";
		linux,phandle = <0x88>;
		phandle = <0x88>;
	};

	ccu@1a0a0000 {
		compatible = "mediatek,ccu";
		reg = <0x00 0x1a0a1000 0x00 0x1000>;
		interrupts = <0x00 0x108 0x08>;
		clocks = <0x4a 0x09 0x2c 0x06>;
		clock-names = "CCU_CLK_CAM_CCU\0CCU_CLK_MMSYS_CCU";
	};

	alc@60000000 {
		compatible = "mediatek,alc";
		reg = <0x00 0x60000000 0x00 0x1000>;
	};

	md_config@80000000 {
		compatible = "mediatek,md_config";
		reg = <0x00 0x80000000 0x00 0x1000>;
	};

	md_uart0@80010000 {
		compatible = "mediatek,md_uart0";
		reg = <0x00 0x80010000 0x00 0x1000>;
	};

	md_p_dma@80020000 {
		compatible = "mediatek,md_p_dma";
		reg = <0x00 0x80020000 0x00 0x1000>;
	};

	md_gpt@80030000 {
		compatible = "mediatek,md_gpt";
		reg = <0x00 0x80030000 0x00 0x1000>;
	};

	simif1@80040000 {
		compatible = "mediatek,simif1";
		reg = <0x00 0x80040000 0x00 0x1000>;
	};

	simif2@80050000 {
		compatible = "mediatek,simif2";
		reg = <0x00 0x80050000 0x00 0x1000>;
	};

	md_peri_misc@80060000 {
		compatible = "mediatek,md_peri_misc";
		reg = <0x00 0x80060000 0x00 0x1000>;
	};

	md_cirq@f0070000 {
		compatible = "mediatek,md_cirq";
		reg = <0x00 0xf0070000 0x00 0x1000>;
	};

	md_debug1@80080000 {
		compatible = "mediatek,md_debug1";
		reg = <0x00 0x80080000 0x00 0x1000>;
	};

	md_debug2@80090000 {
		compatible = "mediatek,md_debug2";
		reg = <0x00 0x80090000 0x00 0x1000>;
	};

	md_debug3@800a0000 {
		compatible = "mediatek,md_debug3";
		reg = <0x00 0x800a0000 0x00 0x1000>;
	};

	mdpar_dbgmon@800b0000 {
		compatible = "mediatek,mdpar_dbgmon";
		reg = <0x00 0x800b0000 0x00 0x1000>;
	};

	md_peri_clk_ctl@800c0000 {
		compatible = "mediatek,md_peri_clk_ctl";
		reg = <0x00 0x800c0000 0x00 0x1000>;
	};

	md_topsm@f00d0000 {
		compatible = "mediatek,md_topsm";
		reg = <0x00 0xf00d0000 0x00 0x1000>;
	};

	md_ost@f00e0000 {
		compatible = "mediatek,md_ost";
		reg = <0x00 0xf00e0000 0x00 0x1000>;
	};

	md_rgu@f00f0000 {
		compatible = "mediatek,md_rgu";
		reg = <0x00 0xf00f0000 0x00 0x1000>;
		interrupts = <0x00 0x11b 0x02>;
	};

	md_i2c@80100000 {
		compatible = "mediatek,md_i2c";
		reg = <0x00 0x80100000 0x00 0x1000>;
	};

	md_eint@80110000 {
		compatible = "mediatek,md_eint";
		reg = <0x00 0x80110000 0x00 0x1000>;
	};

	md_clkctl@80120000 {
		compatible = "mediatek,md_clkctl";
		reg = <0x00 0x80120000 0x00 0x1000>;
	};

	md_global_con_dcm@80130000 {
		compatible = "mediatek,md_global_con_dcm";
		reg = <0x00 0x80130000 0x00 0x1000>;
	};

	md_pll_mixedsys@80140000 {
		compatible = "mediatek,md_pll_mixedsys";
		reg = <0x00 0x80140000 0x00 0x1000>;
	};

	md_clksw@80150000 {
		compatible = "mediatek,md_clksw";
		reg = <0x00 0x80150000 0x00 0x1000>;
	};

	a7_ost@f0160000 {
		compatible = "mediatek,a7_ost";
		reg = <0x00 0xf0160000 0x00 0x1000>;
	};

	md_lite_gpt@80170000 {
		compatible = "mediatek,md_lite_gpt";
		reg = <0x00 0x80170000 0x00 0x1000>;
	};

	mdperi_mbist_config@801a0000 {
		compatible = "mediatek,mdperi_mbist_config";
		reg = <0x00 0x801a0000 0x00 0x1000>;
	};

	md_sdf_top@801b0000 {
		compatible = "mediatek,md_sdf_top";
		reg = <0x00 0x801b0000 0x00 0x1000>;
	};

	psmcu_misc@80200000 {
		compatible = "mediatek,psmcu_misc";
		reg = <0x00 0x80200000 0x00 0x1000>;
	};

	psmcu_busmon@80210000 {
		compatible = "mediatek,psmcu_busmon";
		reg = <0x00 0x80210000 0x00 0x1000>;
	};

	md_pcm@80220000 {
		compatible = "mediatek,md_pcm";
		reg = <0x00 0x80220000 0x00 0x1000>;
	};

	psmcu_mbist_config@80240000 {
		compatible = "mediatek,psmcu_mbist_config";
		reg = <0x00 0x80240000 0x00 0x1000>;
	};

	md_elm@80250000 {
		compatible = "mediatek,md_elm";
		reg = <0x00 0x80250000 0x00 0x1000>;
	};

	md_abm@80260000 {
		compatible = "mediatek,md_abm";
		reg = <0x00 0x80260000 0x00 0x1000>;
	};

	md_soe@80310000 {
		compatible = "mediatek,md_soe";
		reg = <0x00 0x80310000 0x00 0x1000>;
		interrupts = <0x00 0x11e 0x08>;
	};

	md_infra_busmon@80320000 {
		compatible = "mediatek,md_infra_busmon";
		reg = <0x00 0x80320000 0x00 0x1000>;
	};

	md_uart1@80330000 {
		compatible = "mediatek,md_uart1";
		reg = <0x00 0x80330000 0x00 0x1000>;
	};

	md_uart2@80340000 {
		compatible = "mediatek,md_uart2";
		reg = <0x00 0x80340000 0x00 0x1000>;
	};

	mdinfra_mbist_config@80350000 {
		compatible = "mediatek,mdinfra_mbist_config";
		reg = <0x00 0x80350000 0x00 0x1000>;
	};

	mdsys_mbist_config@80360000 {
		compatible = "mediatek,mdsys_mbist_config";
		reg = <0x00 0x80360000 0x00 0x1000>;
	};

	mdsmicfg@803a0000 {
		compatible = "mediatek,mdsmicfg";
		reg = <0x00 0x803a0000 0x00 0x1000>;
	};

	mdinfra_misc@803b0000 {
		compatible = "mediatek,mdinfra_misc";
		reg = <0x00 0x803b0000 0x00 0x1000>;
	};

	md_bus_recoder@803c0000 {
		compatible = "mediatek,md_bus_recoder";
		reg = <0x00 0x803c0000 0x00 0x1000>;
	};

	md_ppc_top@803d0000 {
		compatible = "mediatek,md_ppc_top";
		reg = <0x00 0x803d0000 0x00 0x1000>;
	};

	a7_wdt@f0400000 {
		compatible = "mediatek,a7_wdt";
		reg = <0x00 0xf0400000 0x00 0x1000>;
	};

	a7_mbist_config@f0410000 {
		compatible = "mediatek,a7_mbist_config";
		reg = <0x00 0xf0410000 0x00 0x1000>;
	};

	a7_cirq@f0420000 {
		compatible = "mediatek,a7_cirq";
		reg = <0x00 0xf0420000 0x00 0x1000>;
	};

	pf_bsi_apb1@80200000 {
		compatible = "mediatek,pf_bsi_apb1";
		reg = <0x00 0x80200000 0x00 0x1000>;
	};

	pf_bsi_apb2@80201000 {
		compatible = "mediatek,pf_bsi_apb2";
		reg = <0x00 0x80201000 0x00 0x1000>;
	};

	rfic1_bsispi@80202000 {
		compatible = "mediatek,rfic1_bsispi";
		reg = <0x00 0x80202000 0x00 0x1000>;
	};

	rfic2_bsispi@80203000 {
		compatible = "mediatek,rfic2_bsispi";
		reg = <0x00 0x80203000 0x00 0x1000>;
	};

	mipi0_bsispi@80205000 {
		compatible = "mediatek,mipi0_bsispi";
		reg = <0x00 0x80205000 0x00 0x1000>;
	};

	mipi1_bsispi@80206000 {
		compatible = "mediatek,mipi1_bsispi";
		reg = <0x00 0x80206000 0x00 0x1000>;
	};

	idc_suart@80207000 {
		compatible = "mediatek,idc_suart";
		reg = <0x00 0x80207000 0x00 0x1000>;
	};

	mdm_psys_misc@8020d000 {
		compatible = "mediatek,mdm_psys_misc";
		reg = <0x00 0x8020d000 0x00 0x1000>;
	};

	mdm_psys_mbistcon@8020e000 {
		compatible = "mediatek,mdm_psys_mbistcon";
		reg = <0x00 0x8020e000 0x00 0x1000>;
	};

	md1_abb_mixedsys@8020c000 {
		compatible = "mediatek,md1_abb_mixedsys";
		reg = <0x00 0x8020c000 0x00 0x1000>;
	};

	md2_abb_mixedsys@8020c000 {
		compatible = "mediatek,md2_abb_mixedsys";
		reg = <0x00 0x8020c000 0x00 0x1000>;
	};

	idma@82000000 {
		compatible = "mediatek,idma";
		reg = <0x00 0x82000000 0x00 0x1000>;
	};

	ahb2dspio@82800000 {
		compatible = "mediatek,ahb2dspio";
		reg = <0x00 0x82800000 0x00 0x1000>;
	};

	md2g_confg@82c00000 {
		compatible = "mediatek,md2g_confg";
		reg = <0x00 0x82c00000 0x00 0x1000>;
	};

	apc@82c30000 {
		compatible = "mediatek,apc";
		reg = <0x00 0x82c30000 0x00 0x1000>;
	};

	csd_acc@82c70000 {
		compatible = "mediatek,csd_acc";
		reg = <0x00 0x82c70000 0x00 0x1000>;
	};

	share_d1@82ca0000 {
		compatible = "mediatek,share_d1";
		reg = <0x00 0x82ca0000 0x00 0x1000>;
	};

	irdma@82cb0000 {
		compatible = "mediatek,irdma";
		reg = <0x00 0x82cb0000 0x00 0x1000>;
	};

	patch@82cc0000 {
		compatible = "mediatek,patch";
		reg = <0x00 0x82cc0000 0x00 0x1000>;
	};

	mdafe@82cd0000 {
		compatible = "mediatek,mdafe";
		reg = <0x00 0x82cd0000 0x00 0x1000>;
	};

	bfe@82ce0000 {
		compatible = "mediatek,bfe";
		reg = <0x00 0x82ce0000 0x00 0x1000>;
	};

	modem_lite_confg@83000000 {
		compatible = "mediatek,modem_lite_confg";
		reg = <0x00 0x83000000 0x00 0x1000>;
	};

	modem_lite_topsm@83010000 {
		compatible = "mediatek,modem_lite_topsm";
		reg = <0x00 0x83010000 0x00 0x1000>;
	};

	tdma@83020000 {
		compatible = "mediatek,tdma";
		reg = <0x00 0x83020000 0x00 0x1000>;
	};

	shreg2@83030000 {
		compatible = "mediatek,shreg2";
		reg = <0x00 0x83030000 0x00 0x1000>;
	};

	divider@83040000 {
		compatible = "mediatek,divider";
		reg = <0x00 0x83040000 0x00 0x1000>;
	};

	fcs@83050000 {
		compatible = "mediatek,fcs";
		reg = <0x00 0x83050000 0x00 0x1000>;
	};

	gcu@83060000 {
		compatible = "mediatek,gcu";
		reg = <0x00 0x83060000 0x00 0x1000>;
	};

	bsi_2g@83070000 {
		compatible = "mediatek,bsi_2g";
		reg = <0x00 0x83070000 0x00 0x1000>;
	};

	bpi_2g@83080000 {
		compatible = "mediatek,bpi_2g";
		reg = <0x00 0x83080000 0x00 0x1000>;
	};

	afc_2g@83090000 {
		compatible = "mediatek,afc_2g";
		reg = <0x00 0x83090000 0x00 0x1000>;
	};

	tdd@84000000 {
		compatible = "mediatek,tdd";
		reg = <0x00 0x84000000 0x00 0x1000>;
	};

	l2ulsbdma@85000000 {
		compatible = "mediatek,l2ulsbdma";
		reg = <0x00 0x85000000 0x00 0x1000>;
	};

	l2ulhbdma@85010000 {
		compatible = "mediatek,l2ulhbdma";
		reg = <0x00 0x85010000 0x00 0x1000>;
	};

	l2dlsbdma@85020000 {
		compatible = "mediatek,l2dlsbdma";
		reg = <0x00 0x85020000 0x00 0x1000>;
	};

	l2dlhbdma@85030000 {
		compatible = "mediatek,l2dlhbdma";
		reg = <0x00 0x85030000 0x00 0x1000>;
	};

	l2mbist@85040000 {
		compatible = "mediatek,l2mbist";
		reg = <0x00 0x85040000 0x00 0x1000>;
	};

	l2pseuphy@85050000 {
		compatible = "mediatek,l2pseuphy";
		reg = <0x00 0x85050000 0x00 0x1000>;
	};

	l2hwlog@85058000 {
		compatible = "mediatek,l2hwlog";
		reg = <0x00 0x85058000 0x00 0x1000>;
	};

	l2soindma@85060000 {
		compatible = "mediatek,l2soindma";
		reg = <0x00 0x85060000 0x00 0x1000>;
	};

	l2sooutdma@85070000 {
		compatible = "mediatek,l2sooutdma";
		reg = <0x00 0x85070000 0x00 0x1000>;
	};

	l2ullmac@85080000 {
		compatible = "mediatek,l2ullmac";
		reg = <0x00 0x85080000 0x00 0x1000>;
	};

	l2dllmac@85090000 {
		compatible = "mediatek,l2dllmac";
		reg = <0x00 0x85090000 0x00 0x1000>;
	};

	l2calmac@85098000 {
		compatible = "mediatek,l2calmac";
		reg = <0x00 0x85098000 0x00 0x1000>;
	};

	l2ulfifomng@850a0000 {
		compatible = "mediatek,l2ulfifomng";
		reg = <0x00 0x850a0000 0x00 0x1000>;
	};

	l2dlfifomng@850a4000 {
		compatible = "mediatek,l2dlfifomng";
		reg = <0x00 0x850a4000 0x00 0x1000>;
	};

	l2sofifomng@850a8000 {
		compatible = "mediatek,l2sofifomng";
		reg = <0x00 0x850a8000 0x00 0x1000>;
	};

	l2sec@850b0000 {
		compatible = "mediatek,l2sec";
		reg = <0x00 0x850b0000 0x00 0x1000>;
	};

	l2ulsecctl@850b4000 {
		compatible = "mediatek,l2ulsecctl";
		reg = <0x00 0x850b4000 0x00 0x1000>;
	};

	l2dlsecctl@850b8000 {
		compatible = "mediatek,l2dlsecctl";
		reg = <0x00 0x850b8000 0x00 0x1000>;
	};

	l2sosecctl@850bc000 {
		compatible = "mediatek,l2sosecctl";
		reg = <0x00 0x850bc000 0x00 0x1000>;
	};

	l2misc@850c0000 {
		compatible = "mediatek,l2misc";
		reg = <0x00 0x850c0000 0x00 0x1000>;
	};

	l2ulbuf@850e0000 {
		compatible = "mediatek,l2ulbuf";
		reg = <0x00 0x850e0000 0x00 0x1000>;
	};

	l2dlbuf@850f0000 {
		compatible = "mediatek,l2dlbuf";
		reg = <0x00 0x850f0000 0x00 0x1000>;
	};

	mdl1ao@f60f0000 {
		compatible = "mediatek,mdl1ao";
		reg = <0x00 0xf60f0000 0x00 0x1000>;
	};

	modem_confg@87000000 {
		compatible = "mediatek,modem_confg";
		reg = <0x00 0x87000000 0x00 0x1000>;
	};

	modem_topsm@87010000 {
		compatible = "mediatek,modem_topsm";
		reg = <0x00 0x87010000 0x00 0x1000>;
	};

	bsi_3g@87070000 {
		compatible = "mediatek,bsi_3g";
		reg = <0x00 0x87070000 0x00 0x1000>;
	};

	bpi_3g@87080000 {
		compatible = "mediatek,bpi_3g";
		reg = <0x00 0x87080000 0x00 0x1000>;
	};

	afc_3g@87090000 {
		compatible = "mediatek,afc_3g";
		reg = <0x00 0x87090000 0x00 0x1000>;
	};

	wcdma_timer@870a0000 {
		compatible = "mediatek,wcdma_timer";
		reg = <0x00 0x870a0000 0x00 0x1000>;
	};

	dpa_bc@870b0000 {
		compatible = "mediatek,dpa_bc";
		reg = <0x00 0x870b0000 0x00 0x1000>;
	};

	pfc_encode@870c0000 {
		compatible = "mediatek,pfc_encode";
		reg = <0x00 0x870c0000 0x00 0x1000>;
	};

	pfc_decode@870d0000 {
		compatible = "mediatek,pfc_decode";
		reg = <0x00 0x870d0000 0x00 0x1000>;
	};

	hspasys_1_confg@87200000 {
		compatible = "mediatek,hspasys_1_confg";
		reg = <0x00 0x87200000 0x00 0x1000>;
	};

	hseq@87210000 {
		compatible = "mediatek,hseq";
		reg = <0x00 0x87210000 0x00 0x1000>;
	};

	hsce@87220000 {
		compatible = "mediatek,hsce";
		reg = <0x00 0x87220000 0x00 0x1000>;
	};

	hspasys_1_mbist@87230000 {
		compatible = "mediatek,hspasys_1_mbist";
		reg = <0x00 0x87230000 0x00 0x1000>;
	};

	hspasys_2_confg@87400000 {
		compatible = "mediatek,hspasys_2_confg";
		reg = <0x00 0x87400000 0x00 0x1000>;
	};

	hseq_dc@87410000 {
		compatible = "mediatek,hseq_dc";
		reg = <0x00 0x87410000 0x00 0x1000>;
	};

	hsce_dc@87420000 {
		compatible = "mediatek,hsce_dc";
		reg = <0x00 0x87420000 0x00 0x1000>;
	};

	rake_dc@87430000 {
		compatible = "mediatek,rake_dc";
		reg = <0x00 0x87430000 0x00 0x1000>;
	};

	hspasys_2_mbist@87440000 {
		compatible = "mediatek,hspasys_2_mbist";
		reg = <0x00 0x87440000 0x00 0x1000>;
	};

	uea_uia_u0@87600000 {
		compatible = "mediatek,uea_uia_u0";
		reg = <0x00 0x87600000 0x00 0x1000>;
	};

	uea_uia_u1@87610000 {
		compatible = "mediatek,uea_uia_u1";
		reg = <0x00 0x87610000 0x00 0x1000>;
	};

	dpa_rlc@87620000 {
		compatible = "mediatek,dpa_rlc";
		reg = <0x00 0x87620000 0x00 0x1000>;
	};

	dpa_mac@87630000 {
		compatible = "mediatek,dpa_mac";
		reg = <0x00 0x87630000 0x00 0x1000>;
	};

	upa@f0920000 {
		compatible = "mediatek,upa";
		reg = <0x00 0xf0920000 0x00 0x1000>;
	};

	h_rxbrp@87650000 {
		compatible = "mediatek,h_rxbrp";
		reg = <0x00 0x87650000 0x00 0x1000>;
	};

	rxbrp@87660000 {
		compatible = "mediatek,rxbrp";
		reg = <0x00 0x87660000 0x00 0x1000>;
	};

	hspasys_3_confg@f0910000 {
		compatible = "mediatek,hspasys_3_confg";
		reg = <0x00 0xf0910000 0x00 0x1000>;
	};

	txbrp@87680000 {
		compatible = "mediatek,txbrp";
		reg = <0x00 0x87680000 0x00 0x1000>;
	};

	txcrp@87690000 {
		compatible = "mediatek,txcrp";
		reg = <0x00 0x87690000 0x00 0x1000>;
	};

	h_txbrp@876a0000 {
		compatible = "mediatek,h_txbrp";
		reg = <0x00 0x876a0000 0x00 0x1000>;
	};

	txupc@876b0000 {
		compatible = "mediatek,txupc";
		reg = <0x00 0x876b0000 0x00 0x1000>;
	};

	bc@876c0000 {
		compatible = "mediatek,bc";
		reg = <0x00 0x876c0000 0x00 0x1000>;
	};

	dbg_tx@876d0000 {
		compatible = "mediatek,dbg_tx";
		reg = <0x00 0x876d0000 0x00 0x1000>;
	};

	hspasys_3_mbist@876e0000 {
		compatible = "mediatek,hspasys_3_mbist";
		reg = <0x00 0x876e0000 0x00 0x1000>;
	};

	rxsrp@87800000 {
		compatible = "mediatek,rxsrp";
		reg = <0x00 0x87800000 0x00 0x1000>;
	};

	indec@87810000 {
		compatible = "mediatek,indec";
		reg = <0x00 0x87810000 0x00 0x1000>;
	};

	rake_0@87820000 {
		compatible = "mediatek,rake_0";
		reg = <0x00 0x87820000 0x00 0x1000>;
	};

	rake_1@87830000 {
		compatible = "mediatek,rake_1";
		reg = <0x00 0x87830000 0x00 0x1000>;
	};

	rake_2@87840000 {
		compatible = "mediatek,rake_2";
		reg = <0x00 0x87840000 0x00 0x1000>;
	};

	searcher@87850000 {
		compatible = "mediatek,searcher";
		reg = <0x00 0x87850000 0x00 0x1000>;
	};

	rxdfe@87860000 {
		compatible = "mediatek,rxdfe";
		reg = <0x00 0x87860000 0x00 0x1000>;
	};

	hspasys_4_confg@87870000 {
		compatible = "mediatek,hspasys_4_confg";
		reg = <0x00 0x87870000 0x00 0x1000>;
	};

	dbg@87880000 {
		compatible = "mediatek,dbg";
		reg = <0x00 0x87880000 0x00 0x1000>;
	};

	dwrap0@87890000 {
		compatible = "mediatek,dwrap0";
		reg = <0x00 0x87890000 0x00 0x1000>;
	};

	log3g@878a0000 {
		compatible = "mediatek,log3g";
		reg = <0x00 0x878a0000 0x00 0x1000>;
	};

	hspasys_4_mbist@878b0000 {
		compatible = "mediatek,hspasys_4_mbist";
		reg = <0x00 0x878b0000 0x00 0x1000>;
	};

	dwrap1@878c0000 {
		compatible = "mediatek,dwrap1";
		reg = <0x00 0x878c0000 0x00 0x1000>;
	};

	c2ksys@38000000 {
		compatible = "mediatek,c2ksys";
		reg = <0x00 0x38000000 0x00 0x1000>;
	};

	usbphy {
		compatible = "usb-nop-xceiv";
		linux,phandle = <0x89>;
		phandle = <0x89>;
	};

	usb3_phy {
		compatible = "mediatek,usb3_phy";
		clocks = <0x15 0x5b 0x15 0x3e>;
		clock-names = "ssusb_clk\0sys_ck";
	};

	mt_soc_btcvsd_rx_pcm {
		compatible = "mediatek,mt_soc_btcvsd_rx_pcm";
	};

	mt_soc_btcvsd_tx_pcm {
		compatible = "mediatek,mt_soc_btcvsd_tx_pcm";
	};

	mt_soc_deep_buffer_dl_pcm {
		compatible = "mediatek,mt_soc_pcm_deep_buffer_dl";
	};

	mt_soc_ul1_pcm {
		compatible = "mediatek,mt_soc_pcm_capture";
	};

	mt_soc_voice_md1 {
		compatible = "mediatek,mt_soc_pcm_voice_md1";
	};

	mt_soc_hdmi_pcm {
		compatible = "mediatek,mt_soc_pcm_hdmi";
	};

	mt_soc_uldlloopback_pcm {
		compatible = "mediatek,mt_soc_pcm_uldlloopback";
	};

	mt_soc_i2s0_pcm {
		compatible = "mediatek,mt_soc_pcm_dl1_i2s0";
	};

	mt_soc_mrgrx_pcm {
		compatible = "mediatek,mt_soc_pcm_mrgrx";
	};

	mt_soc_mrgrx_awb_pcm {
		compatible = "mediatek,mt_soc_pcm_mrgrx_awb";
	};

	mt_soc_fm_i2s_pcm {
		compatible = "mediatek,mt_soc_pcm_fm_i2s";
	};

	mt_soc_fm_i2s_awb_pcm {
		compatible = "mediatek,mt_soc_pcm_fm_i2s_awb";
	};

	mt_soc_i2s0dl1_pcm {
		compatible = "mediatek,mt_soc_pcm_dl1_i2s0dl1";
	};

	mt_soc_dl1_awb_pcm {
		compatible = "mediatek,mt_soc_pcm_dl1_awb";
	};

	mt_soc_voice_md1_bt {
		compatible = "mediatek,mt_soc_pcm_voice_md1_bt";
	};

	mt_soc_voip_bt_out {
		compatible = "mediatek,mt_soc_pcm_dl1_bt";
	};

	mt_soc_voip_bt_in {
		compatible = "mediatek,mt_soc_pcm_bt_dai";
	};

	mt_soc_tdmrx_pcm {
		compatible = "mediatek,mt_soc_tdm_capture";
	};

	mt_soc_fm_mrgtx_pcm {
		compatible = "mediatek,mt_soc_pcm_fmtx";
	};

	mt_soc_ul2_pcm {
		compatible = "mediatek,mt_soc_pcm_capture2";
	};

	mt_soc_i2s0_awb_pcm {
		compatible = "mediatek,mt_soc_pcm_i2s0_awb";
	};

	mt_soc_voice_md2 {
		compatible = "mediatek,mt_soc_pcm_voice_md2";
	};

	mt_soc_pcm_dl1_scp_spk {
		compatible = "mediatek,mt_soc_pcm_dl1_scp_spk";
	};

	mt_soc_pcm_voice_scp {
		compatible = "mediatek,mt_soc_pcm_voice_scp";
	};

	mt_soc_routing_pcm {
		compatible = "mediatek,mt_soc_pcm_routing";
	};

	mt_soc_voice_md2_bt {
		compatible = "mediatek,mt_soc_pcm_voice_md2_bt";
	};

	mt_soc_hp_impedance_pcm {
		compatible = "mediatek,mt_soc_pcm_hp_impedance";
	};

	mt_soc_codec_name {
		compatible = "mediatek,mt_soc_codec_63xx";
		use_hp_depop_flow = <0x00>;
		use_ul_260k = <0x00>;
		pcbinfo = <0x1b 0xaf 0x00 0x1b 0x6f 0x00>;
	};

	mt_soc_dummy_pcm {
		compatible = "mediatek,mt_soc_pcm_dummy";
	};

	mt_soc_codec_dummy_name {
		compatible = "mediatek,mt_soc_codec_dummy";
	};

	mt_soc_routing_dai_name {
		compatible = "mediatek,mt_soc_dai_routing";
	};

	mt_soc_dai_name {
		compatible = "mediatek,mt_soc_dai_stub";
	};

	mt_soc_dl2_pcm {
		compatible = "mediatek,mt_soc_pcm_dl2";
	};

	mt_soc_anc_pcm {
		compatible = "mediatek,mt_soc_pcm_anc";
	};

	mt_soc_pcm_voice_ultra {
		compatible = "mediatek,mt_soc_pcm_voice_ultra";
	};

	mt_soc_pcm_voice_usb {
		compatible = "mediatek,mt_soc_pcm_voice_usb";
	};

	mt_soc_pcm_voice_usb_echoref {
		compatible = "mediatek,mt_soc_pcm_voice_usb_echoref";
	};

	mt_soc_vow_barge_in_pcm {
		compatible = "mediatek,mt_soc_pcm_vow_barge_in";
	};

	firmware {

		android {
			compatible = "android,firmware";

			fstab {
				compatible = "android,fstab";

				vendor {
					compatible = "android,vendor";
					dev = "/dev/block/platform/bootdevice/by-name/vendor";
					type = "ext4";
					mnt_flags = "ro";
					fsmgr_flags = "wait,verify";
				};
			};
		};
	};

	odm {
		compatible = "simple-bus";
		linux,phandle = <0x8a>;
		phandle = <0x8a>;
	};

	radio_md_cfg {
		compatible = "mediatek,radio_md_cfg";
		linux,phandle = <0x8b>;
		phandle = <0x8b>;
	};

	dynamic_options {
		compatible = "mediatek,dynamic_options";
		linux,phandle = <0x8c>;
		phandle = <0x8c>;
	};

	mt_charger {
		compatible = "mediatek,mt-charger";
		linux,phandle = <0x8d>;
		phandle = <0x8d>;
	};

	lk_charger {
		compatible = "mediatek,lk_charger";
		enable_pe_plus;
		power_path_support;
		max_charger_voltage = <0x632ea0>;
		fast_charge_voltage = <0x2dc6c0>;
		usb_charger_current = <0x7a120>;
		ac_charger_current = <0x1e8480>;
		ac_charger_input_current = <0x1e8480>;
		non_std_ac_charger_current = <0x7a120>;
		charging_host_charger_current = <0x16e360>;
		ta_ac_charger_current = <0x1e8480>;
		pd_charger_current = <0x7a120>;
		temp_t4_threshold = <0x32>;
		temp_t3_threshold = <0x2d>;
		temp_t1_threshold = <0x00>;
		linux,phandle = <0x8e>;
		phandle = <0x8e>;
	};

	charger {
		compatible = "mediatek,charger";
		algorithm_name = "SwitchCharging";
		enable_pe_plus;
		enable_pe_2;
		enable_pe_3;
		enable_pe_4;
		enable_type_c;
		power_path_support;
		battery_cv = <0x426030>;
		max_charger_voltage = <0x632ea0>;
		min_charger_voltage = <0x4630c0>;
		usb_charger_current_suspend = <0x00>;
		usb_charger_current_unconfigured = <0x11170>;
		usb_charger_current_configured = <0x7a120>;
		usb_charger_current = <0x7a120>;
		ac_charger_current = <0x1f47d0>;
		ac_charger_input_current = <0x30d400>;
		non_std_ac_charger_current = <0x7a120>;
		charging_host_charger_current = <0x16e360>;
		apple_1_0a_charger_current = <0x9eb10>;
		apple_2_1a_charger_current = "\0\f5";
		ta_ac_charger_current = <0x2dc6c0>;
		jeita_temp_above_t4_cv_voltage = <0x40b280>;
		jeita_temp_t3_to_t4_cv_voltage = <0x40b280>;
		jeita_temp_t2_to_t3_cv_voltage = <0x423920>;
		jeita_temp_t1_to_t2_cv_voltage = <0x40b280>;
		jeita_temp_t0_to_t1_cv_voltage = <0x3da540>;
		jeita_temp_below_t0_cv_voltage = <0x3da540>;
		temp_t4_threshold = <0x32>;
		temp_t4_thres_minus_x_degree = <0x2f>;
		temp_t3_threshold = <0x2d>;
		temp_t3_thres_minus_x_degree = <0x27>;
		temp_t2_threshold = <0x0a>;
		temp_t2_thres_plus_x_degree = <0x10>;
		temp_t1_threshold = <0x00>;
		temp_t1_thres_plus_x_degree = <0x06>;
		temp_t0_threshold = <0x00>;
		temp_t0_thres_plus_x_degree = <0x00>;
		temp_neg_10_threshold = <0x00>;
		enable_min_charge_temperature;
		min_charge_temperature = <0x00>;
		min_charge_temperature_plus_x_degree = <0x06>;
		max_charge_temperature = <0x3b>;
		max_charge_temperature_minus_x_degree = <0x35>;
		pe20_ichg_level_threshold = <0x3e8>;
		ta_start_battery_soc = <0x00>;
		ta_stop_battery_soc = <0x55>;
		pe40_single_charger_input_current = <0x2dc6c0>;
		pe40_single_charger_current = <0x2dc6c0>;
		pe40_dual_charger_input_current = <0x2dc6c0>;
		pe40_dual_charger_chg1_current = <0x1e8480>;
		pe40_dual_charger_chg2_current = <0x1e8480>;
		pe40_stop_battery_soc = <0x50>;
		chg1_ta_ac_charger_current = <0x16e360>;
		chg2_ta_ac_charger_current = <0x16e360>;
		cable_imp_threshold = <0x2bb>;
		vbat_cable_imp_threshold = <0xf3c>;
		bif_threshold1 = <0x40d990>;
		bif_threshold2 = <0x419ce0>;
		bif_cv_under_threshold2 = <0x43e6d0>;
		linux,phandle = <0x8f>;
		phandle = <0x8f>;
	};

	rt9465_slave_chr {
		compatible = "richtek,rt9465";
		linux,phandle = <0x90>;
		phandle = <0x90>;
	};

	rt-pd-manager {
		compatible = "mediatek,rt-pd-manager";
	};

	mt6370_pmu_eint {
		linux,phandle = <0x91>;
		phandle = <0x91>;
	};

	fingerprint {
		compatible = "mediatek,fingerprint";
		linux,phandle = <0x92>;
		phandle = <0x92>;
	};

	mcu {
		compatible = "mediatek,mcu";
		linux,phandle = <0x93>;
		phandle = <0x93>;
	};

	lepton_spi {
		compatible = "flir, lepton-spi";
		linux,phandle = <0x94>;
		phandle = <0x94>;
	};

	mt6370_pd_eint {
		linux,phandle = <0x95>;
		phandle = <0x95>;
	};

	scp_dvfs {
		compatible = "mediatek,scp_dvfs";
		clocks = <0x3f 0x0f 0x3d 0x3f 0x42 0x3f 0x2e 0x3f 0x30 0x3f 0x40 0x3f 0x2d 0x3f 0x3d>;
		clock-names = "clk_mux\0clk_pll_0\0clk_pll_1\0clk_pll_2\0clk_pll_3\0clk_pll_4\0clk_pll_5\0clk_pll_6";
	};

	rt5081_pmu_eint {
		linux,phandle = <0x96>;
		phandle = <0x96>;
	};

	rt5081_pd_eint {
		linux,phandle = <0x97>;
		phandle = <0x97>;
	};

	pmic_clock_buffer_ctrl {
		compatible = "mediatek,pmic_clock_buffer";
		mediatek,clkbuf-quantity = <0x07>;
		mediatek,clkbuf-config = <0x02 0x01 0x01 0x02 0x00 0x00 0x01>;
		mediatek,clkbuf-driving-current = <0x01 0x01 0x01 0x01 0x01 0x01 0x01>;
		linux,phandle = <0x98>;
		phandle = <0x98>;
	};

	msdc1_ins {
		linux,phandle = <0x99>;
		phandle = <0x99>;
	};

	gyro {
		linux,phandle = <0x9a>;
		phandle = <0x9a>;
	};

	mse {
		linux,phandle = <0x9b>;
		phandle = <0x9b>;
	};

	als {
		linux,phandle = <0x9c>;
		phandle = <0x9c>;
	};

	otg_iddig {
		compatible = "mediatek,usb_iddig_bi_eint";
		linux,phandle = <0x9d>;
		phandle = <0x9d>;
	};

	nfc {
		compatible = "mediatek,nfc-gpio-v2";
		gpio-rst = <0x13>;
		gpio-rst-std = <0x1b 0x13 0x00>;
		gpio-irq = <0x14>;
		gpio-irq-std = <0x1b 0x14 0x00>;
		linux,phandle = <0x9e>;
		phandle = <0x9e>;
	};

	irq_nfc {
		compatible = "mediatek,irq_nfc-eint";
		linux,phandle = <0x9f>;
		phandle = <0x9f>;
	};

	smart_pa {
		linux,phandle = <0xa0>;
		phandle = <0xa0>;
	};

	md1_sim1_hot_plug_eint {
		linux,phandle = <0xa1>;
		phandle = <0xa1>;
	};

	md1_sim2_hot_plug_eint {
		linux,phandle = <0xa2>;
		phandle = <0xa2>;
	};

	usb_c_pinctrl {
		linux,phandle = <0xa3>;
		phandle = <0xa3>;
	};

	ssusb_ip_sleep {
		compatible = "mediatek,usb_ipsleep";
		interrupt-parent = <0x1b>;
		interrupts = <0xb3 0x08 0xbb 0x00>;
		status = "okay";
		linux,phandle = <0xa4>;
		phandle = <0xa4>;
	};

	aliases {
		spi0 = "/spi@1100a000";
		spi1 = "/spi@11010000";
		spi2 = "/spi@11012000";
		spi3 = "/spi@11013000";
		spi4 = "/spi@11018000";
		spi5 = "/spi@11019000";
	};

	mt_pmic_regulator {
		compatible = "mediatek,mt_pmic";

		buck_regulators {
			compatible = "mediatek,mt_pmic_buck_regulators";

			buck_vdram1 {
				regulator-name = "vdram1";
				regulator-min-microvolt = <0x7a120>;
				regulator-max-microvolt = <0x1fda4c>;
				regulator-ramp-delay = <0x30d4>;
				regulator-enable-ramp-delay = <0x00>;
				linux,phandle = <0xa5>;
				phandle = <0xa5>;
			};

			buck_vcore {
				regulator-name = "vcore";
				regulator-min-microvolt = <0x7a120>;
				regulator-max-microvolt = <0x13bdb6>;
				regulator-ramp-delay = <0x186a>;
				regulator-enable-ramp-delay = <0xc8>;
				linux,phandle = <0xa6>;
				phandle = <0xa6>;
			};

			buck_vpa {
				regulator-name = "vpa";
				regulator-min-microvolt = <0x7a120>;
				regulator-max-microvolt = <0x37b1d0>;
				regulator-ramp-delay = <0xc350>;
				regulator-enable-ramp-delay = <0xfa>;
				linux,phandle = <0xa7>;
				phandle = <0xa7>;
			};

			buck_vproc11 {
				regulator-name = "vproc11";
				regulator-min-microvolt = <0x7a120>;
				regulator-max-microvolt = <0x13bdb6>;
				regulator-ramp-delay = <0x186a>;
				regulator-enable-ramp-delay = <0xc8>;
				linux,phandle = <0xa8>;
				phandle = <0xa8>;
			};

			buck_vproc12 {
				regulator-name = "vproc12";
				regulator-min-microvolt = <0x7a120>;
				regulator-max-microvolt = <0x13bdb6>;
				regulator-ramp-delay = <0x186a>;
				regulator-enable-ramp-delay = <0xc8>;
				linux,phandle = <0xa9>;
				phandle = <0xa9>;
			};

			buck_vgpu {
				regulator-name = "vgpu";
				regulator-min-microvolt = <0x7a120>;
				regulator-max-microvolt = <0x13bdb6>;
				regulator-ramp-delay = <0x186a>;
				regulator-enable-ramp-delay = <0xc8>;
				linux,phandle = <0xaa>;
				phandle = <0xaa>;
			};

			buck_vs2 {
				regulator-name = "vs2";
				regulator-min-microvolt = <0x7a120>;
				regulator-max-microvolt = <0x1fda4c>;
				regulator-ramp-delay = <0x30d4>;
				regulator-enable-ramp-delay = <0x00>;
				linux,phandle = <0xab>;
				phandle = <0xab>;
			};

			buck_vmodem {
				regulator-name = "vmodem";
				regulator-min-microvolt = <0x7a120>;
				regulator-max-microvolt = <0x13bdb6>;
				regulator-ramp-delay = <0x186a>;
				regulator-enable-ramp-delay = <0x384>;
				linux,phandle = <0xac>;
				phandle = <0xac>;
			};

			buck_vs1 {
				regulator-name = "vs1";
				regulator-min-microvolt = <0xf4240>;
				regulator-max-microvolt = <0x277b6c>;
				regulator-ramp-delay = <0x30d4>;
				regulator-enable-ramp-delay = <0x00>;
				linux,phandle = <0xad>;
				phandle = <0xad>;
			};
		};

		ldo_regulators {
			compatible = "mediatek,mt_pmic_ldo_regulators";

			ldo_vdram2 {
				regulator-name = "vdram2";
				regulator-min-microvolt = <0x927c0>;
				regulator-max-microvolt = <0x1b7740>;
				regulator-enable-ramp-delay = <0xce4>;
				linux,phandle = <0xae>;
				phandle = <0xae>;
			};

			ldo_vsim1 {
				regulator-name = "vsim1";
				regulator-min-microvolt = <0x19f0a0>;
				regulator-max-microvolt = <0x2f4d60>;
				regulator-enable-ramp-delay = <0x21c>;
				linux,phandle = <0xaf>;
				phandle = <0xaf>;
			};

			ldo_vibr {
				regulator-name = "vibr";
				regulator-min-microvolt = <0x124f80>;
				regulator-max-microvolt = <0x325aa0>;
				regulator-enable-ramp-delay = <0x3c>;
				linux,phandle = <0xb0>;
				phandle = <0xb0>;
			};

			ldo_vrf12 {
				compatible = "regulator-fixed";
				regulator-name = "vrf12";
				regulator-min-microvolt = <0x124f80>;
				regulator-max-microvolt = <0x124f80>;
				regulator-enable-ramp-delay = <0x78>;
				linux,phandle = <0xb1>;
				phandle = <0xb1>;
			};

			ldo_vio18 {
				compatible = "regulator-fixed";
				regulator-name = "vio18";
				regulator-min-microvolt = <0x1b7740>;
				regulator-max-microvolt = <0x1b7740>;
				regulator-enable-ramp-delay = <0xa8c>;
				linux,phandle = <0xb2>;
				phandle = <0xb2>;
			};

			ldo_vusb {
				regulator-name = "vusb";
				regulator-min-microvolt = <0x2dc6c0>;
				regulator-max-microvolt = <0x2f4d60>;
				regulator-enable-ramp-delay = <0x10e>;
				linux,phandle = <0xb3>;
				phandle = <0xb3>;
			};

			ldo_vcamio {
				compatible = "regulator-fixed";
				regulator-name = "vcamio";
				regulator-min-microvolt = <0x1b7740>;
				regulator-max-microvolt = <0x1b7740>;
				regulator-enable-ramp-delay = <0x10e>;
				linux,phandle = <0xb4>;
				phandle = <0xb4>;
			};

			ldo_vcamd {
				regulator-name = "vcamd";
				regulator-min-microvolt = <0xdbba0>;
				regulator-max-microvolt = <0x1b7740>;
				regulator-enable-ramp-delay = <0x10e>;
				linux,phandle = <0xb5>;
				phandle = <0xb5>;
			};

			ldo_vcn18 {
				compatible = "regulator-fixed";
				regulator-name = "vcn18";
				regulator-min-microvolt = <0x1b7740>;
				regulator-max-microvolt = <0x1b7740>;
				regulator-enable-ramp-delay = <0x10e>;
				linux,phandle = <0xb6>;
				phandle = <0xb6>;
			};

			ldo_vfe28 {
				compatible = "regulator-fixed";
				regulator-name = "vfe28";
				regulator-min-microvolt = <0x2ab980>;
				regulator-max-microvolt = <0x2ab980>;
				regulator-enable-ramp-delay = <0x10e>;
				linux,phandle = <0xb7>;
				phandle = <0xb7>;
			};

			ldo_vsram_proc11 {
				regulator-name = "vsram_proc11";
				regulator-min-microvolt = <0x7a120>;
				regulator-max-microvolt = <0x13bdb6>;
				regulator-ramp-delay = <0x186a>;
				regulator-enable-ramp-delay = <0xf0>;
				linux,phandle = <0xb8>;
				phandle = <0xb8>;
			};

			ldo_vcn28 {
				compatible = "regulator-fixed";
				regulator-name = "vcn28";
				regulator-min-microvolt = <0x2ab980>;
				regulator-max-microvolt = <0x2ab980>;
				regulator-enable-ramp-delay = <0x10e>;
				linux,phandle = <0xb9>;
				phandle = <0xb9>;
			};

			ldo_vsram_others {
				regulator-name = "vsram_others";
				regulator-min-microvolt = <0x7a120>;
				regulator-max-microvolt = <0x13bdb6>;
				regulator-ramp-delay = <0x186a>;
				regulator-enable-ramp-delay = <0xf0>;
				linux,phandle = <0xba>;
				phandle = <0xba>;
			};

			ldo_vsram_gpu {
				regulator-name = "vsram_gpu";
				regulator-min-microvolt = <0x7a120>;
				regulator-max-microvolt = <0x13bdb6>;
				regulator-ramp-delay = <0x186a>;
				regulator-enable-ramp-delay = <0xf0>;
				linux,phandle = <0xbb>;
				phandle = <0xbb>;
			};

			ldo_vxo22 {
				compatible = "regulator-fixed";
				regulator-name = "vxo22";
				regulator-min-microvolt = <0x2191c0>;
				regulator-max-microvolt = <0x2191c0>;
				regulator-enable-ramp-delay = <0x78>;
				linux,phandle = <0xbc>;
				phandle = <0xbc>;
			};

			ldo_vefuse {
				regulator-name = "vefuse";
				regulator-min-microvolt = <0x19f0a0>;
				regulator-max-microvolt = <0x1cfde0>;
				regulator-enable-ramp-delay = <0x10e>;
				linux,phandle = <0xbd>;
				phandle = <0xbd>;
			};

			ldo_vaux18 {
				compatible = "regulator-fixed";
				regulator-name = "vaux18";
				regulator-min-microvolt = <0x1b7740>;
				regulator-max-microvolt = <0x1b7740>;
				regulator-enable-ramp-delay = <0x10e>;
				linux,phandle = <0xbe>;
				phandle = <0xbe>;
			};

			ldo_vmch {
				regulator-name = "vmch";
				regulator-min-microvolt = <0x2c4020>;
				regulator-max-microvolt = <0x325aa0>;
				regulator-enable-ramp-delay = <0x3c>;
				linux,phandle = <0x1c>;
				phandle = <0x1c>;
			};

			ldo_vbif28 {
				compatible = "regulator-fixed";
				regulator-name = "vbif28";
				regulator-min-microvolt = <0x2ab980>;
				regulator-max-microvolt = <0x2ab980>;
				regulator-enable-ramp-delay = <0x10e>;
				linux,phandle = <0xbf>;
				phandle = <0xbf>;
			};

			ldo_vsram_proc12 {
				regulator-name = "vsram_proc12";
				regulator-min-microvolt = <0x7a120>;
				regulator-max-microvolt = <0x13bdb6>;
				regulator-ramp-delay = <0x186a>;
				regulator-enable-ramp-delay = <0xf0>;
				linux,phandle = <0xc0>;
				phandle = <0xc0>;
			};

			ldo_vcama1 {
				regulator-name = "vcama1";
				regulator-min-microvolt = <0x1b7740>;
				regulator-max-microvolt = <0x2dc6c0>;
				regulator-enable-ramp-delay = <0x10e>;
				linux,phandle = <0xc1>;
				phandle = <0xc1>;
			};

			ldo_vemc {
				regulator-name = "vemc";
				regulator-min-microvolt = <0x2c4020>;
				regulator-max-microvolt = <0x325aa0>;
				regulator-enable-ramp-delay = <0x3c>;
				linux,phandle = <0x14>;
				phandle = <0x14>;
			};

			ldo_vio28 {
				compatible = "regulator-fixed";
				regulator-name = "vio28";
				regulator-min-microvolt = <0x2ab980>;
				regulator-max-microvolt = <0x2ab980>;
				regulator-enable-ramp-delay = <0x10e>;
				linux,phandle = <0xc2>;
				phandle = <0xc2>;
			};

			ldo_va12 {
				compatible = "regulator-fixed";
				regulator-name = "va12";
				regulator-min-microvolt = <0x124f80>;
				regulator-max-microvolt = <0x124f80>;
				regulator-enable-ramp-delay = <0x10e>;
				linux,phandle = <0xc3>;
				phandle = <0xc3>;
			};

			ldo_vrf18 {
				compatible = "regulator-fixed";
				regulator-name = "vrf18";
				regulator-min-microvolt = <0x1b7740>;
				regulator-max-microvolt = <0x1b7740>;
				regulator-enable-ramp-delay = <0x78>;
				linux,phandle = <0xc4>;
				phandle = <0xc4>;
			};

			ldo_vcn33_bt {
				regulator-name = "vcn33_bt";
				regulator-min-microvolt = <0x325aa0>;
				regulator-max-microvolt = <0x3567e0>;
				regulator-enable-ramp-delay = <0x10e>;
				linux,phandle = <0xc5>;
				phandle = <0xc5>;
			};

			ldo_vcn33_wifi {
				regulator-name = "vcn33_wifi";
				regulator-min-microvolt = <0x325aa0>;
				regulator-max-microvolt = <0x3567e0>;
				regulator-enable-ramp-delay = <0x10e>;
				linux,phandle = <0xc6>;
				phandle = <0xc6>;
			};

			ldo_vcama2 {
				regulator-name = "vcama2";
				regulator-min-microvolt = <0x1b7740>;
				regulator-max-microvolt = <0x2dc6c0>;
				regulator-enable-ramp-delay = <0x10e>;
				linux,phandle = <0xc7>;
				phandle = <0xc7>;
			};

			ldo_vmc {
				regulator-name = "vmc";
				regulator-min-microvolt = <0x1b7740>;
				regulator-max-microvolt = <0x325aa0>;
				regulator-enable-ramp-delay = <0x3c>;
				linux,phandle = <0x1d>;
				phandle = <0x1d>;
			};

			ldo_vldo28 {
				regulator-name = "vldo28";
				regulator-min-microvolt = <0x2ab980>;
				regulator-max-microvolt = <0x2dc6c0>;
				regulator-enable-ramp-delay = <0x10e>;
				linux,phandle = <0xc8>;
				phandle = <0xc8>;
			};

			ldo_vaud28 {
				compatible = "regulator-fixed";
				regulator-name = "vaud28";
				regulator-min-microvolt = <0x2ab980>;
				regulator-max-microvolt = <0x2ab980>;
				regulator-enable-ramp-delay = <0x10e>;
				linux,phandle = <0xc9>;
				phandle = <0xc9>;
			};

			ldo_vsim2 {
				regulator-name = "vsim2";
				regulator-min-microvolt = <0x19f0a0>;
				regulator-max-microvolt = <0x2f4d60>;
				regulator-enable-ramp-delay = <0x21c>;
				linux,phandle = <0xca>;
				phandle = <0xca>;
			};

			ldo_va09 {
				compatible = "regulator-fixed";
				regulator-name = "va09";
				regulator-min-microvolt = <0xdbba0>;
				regulator-max-microvolt = <0xdbba0>;
				regulator-enable-ramp-delay = <0x108>;
				regulator-boot-on;
				linux,phandle = <0xcb>;
				phandle = <0xcb>;
			};
		};
	};

	mt6370_pmu_dts {
		interrupt-controller;
		#interrupt-cells = <0x01>;
		mt6370,intr_gpio_num = <0x0a>;
		mt6370,intr_gpio = <0x1b 0x0a 0x00>;
		linux,phandle = <0xcc>;
		phandle = <0xcc>;

		core {
			compatible = "mediatek,mt6370_pmu_core";
			interrupt-names = "otp\0vdda_ovp\0vdda_uv";
			i2cstmr_rst_tmr = <0x00>;
			mrstb_en;
			mrstb_tmr = <0x03>;
			int_wdt = <0x00>;
			int_deg = <0x00>;
		};

		charger {
			compatible = "mediatek,mt6370_pmu_charger";
			interrupt-names = "chg_mivr\0chg_aiclmeasi\0attachi\0ovpctrl_uvp_d_evt\0chg_wdtmri\0chg_vbusov\0chg_tmri\0chg_treg";
			charger_name = "primary_chg";
			load_switch_name = "primary_load_switch";
			ichg = <0x1e8480>;
			aicr = <0x7a120>;
			mivr = <0x432380>;
			cv = <0x426030>;
			ieoc = <0x493e0>;
			safety_timer = <0x0c>;
			dc_wdt = "\0=\t";
			ircmp_resistor = <0x61a8>;
			ircmp_vclamp = <0x7d00>;
			enable_te;
			enable_wdt;
		};

		mt6370_pmu_fled1 {
			compatible = "mediatek,mt6370_pmu_fled1";
			interrupt-names = "fled_lvf\0fled2_short\0fled1_short";
			fled_enable = <0x01>;
			torch_cur = <0x493e0>;
			strobe_cur = <0x124f80>;
			strobe_timeout = <0x960>;
		};

		mt6370_pmu_fled2 {
			compatible = "mediatek,mt6370_pmu_fled2";
			fled_enable = <0x01>;
			torch_cur = <0x30d40>;
			strobe_cur = <0xf4240>;
			strobe_timeout = <0x4b0>;
		};

		ldo {
			compatible = "mediatek,mt6370_pmu_ldo";
			interrupt-names = "ldo_oc";
			ldo_oms = <0x01>;
			ldo_vrc_lt = <0x01>;

			mt6370_ldo {
				regulator-name = "mt6370_ldo";
				regulator-min-microvolt = <0x186a00>;
				regulator-max-microvolt = "\0=\t";
			};
		};

		rgbled {
			compatible = "mediatek,mt6370_pmu_rgbled";
			interrupt-names = "isink4_short\0isink3_short\0isink2_short\0isink1_short\0isink4_open\0isink3_open\0isink2_open\0isink1_open";
			mt,led_name = "mt6370_pmu_led1\0mt6370_pmu_led2\0mt6370_pmu_led3\0mt6370_pmu_led4";
			mt,led_default_trigger = "cc_mode\0cc_mode\0cc_mode\0none";
		};

		bled {
			compatible = "mediatek,mt6370_pmu_bled";
			interrupt-names = "bled_ocp";
			mt,bled_name = "mt6370_pmu_bled";
			mt,chan_en = <0x0a>;
			mt,map_linear;
			mt,bl_ovp_level = <0x03>;
			mt,bl_ocp_level = <0x02>;
			mt,use_pwm;
			mt,pwm_fsample = <0x02>;
			mt,pwm_deglitch = <0x01>;
			mt,pwm_avg_cycle = <0x00>;
			mt,bled_ramptime = <0x03>;
			mt,bled_flash_ramp = <0x01>;
			mt,max_bled_brightness = <0x514>;
		};

		dsv {
			compatible = "mediatek,mt6370_pmu_dsv";
			interrupt-names = "dsv_vneg_ocp\0dsv_vpos_ocp\0dsv_bst_ocp\0dsv_vneg_scp\0dsv_vpos_scp";
			db_ext_en = <0x00>;
			db_periodic_fix = <0x00>;
			db_single_pin = <0x00>;
			db_freq_pm = <0x00>;
			db_periodic_mode = <0x00>;
			db_startup = <0x00>;
			db_vneg_20ms = <0x01>;
			db_vneg_disc = <0x00>;
			db_vpos_20ms = <0x01>;
			db_vpos_disc = <0x00>;
			db_delay = <0x03>;
			db_vbst = <0x1770>;
			db_vpos_slew = <0x01>;
			db_vneg_slew = <0x01>;

			mt6370_dsvp {
				regulator-name = "dsv_pos";
				regulator-min-microvolt = "\0=\t";
				regulator-max-microvolt = <0x5b8d80>;
			};

			mt6370_dsvn {
				regulator-name = "dsv_neg";
				regulator-min-microvolt = "\0=\t";
				regulator-max-microvolt = <0x5b8d80>;
			};
		};
	};

	type_c_port0 {
		tcpc-dual,supported_modes = <0x00>;
		mt-tcpc,name = "type_c_port0";
		mt-tcpc,role_def = <0x04>;
		mt-tcpc,rp_level = <0x00>;
		mt-tcpc,vconn_supply = <0x01>;
		mt-tcpc,notifier_supply_num = <0x03>;
		mt6370pd,intr_gpio = <0x1b 0x29 0x00>;
		mt6370pd,intr_gpio_num = <0x29>;
		linux,phandle = <0xcd>;
		phandle = <0xcd>;

		pd-data {
			pd,vid = <0x29cf>;
			pd,pid = <0x5081>;
			pd,source-cap-ext = <0x171129cf 0x00 0x102 0x00 0x00 0x2000000>;
			pd,mfrs = "RichtekTCPC";
			pd,charging_policy = <0x21>;
			pd,source-pdo-size = <0x01>;
			pd,source-pdo-data = <0x19032>;
			pd,sink-pdo-size = <0x02>;
			pd,sink-pdo-data = <0x190c8 0xc0761e3c>;
			pd,id-vdo-size = <0x03>;
			pd,id-vdo-data = <0xd10029cf 0x00 0x10000>;
			bat,nr = <0x01>;
			pd,country_nr = <0x00>;

			bat-info0 {
				bat,vid = <0x29cf>;
				bat,pid = <0x1711>;
				bat,mfrs = "bat1";
				bat,design_cap = <0xbb8>;
			};
		};

		dpm_caps {
			local_dr_power;
			local_dr_data;
			local_usb_comm;
			local_no_suspend;
			local_vconn_supply;
			attemp_enter_dp_mode;
			attemp_discover_cable;
			attemp_discover_id;
			pr_check = <0x00>;
			pr_check_gp_source;
			dr_check = <0x00>;
		};
	};

	__symbols__ {
		chosen = "/chosen";
		cpu0 = "/cpus/cpu@000";
		cpu1 = "/cpus/cpu@001";
		cpu2 = "/cpus/cpu@002";
		cpu3 = "/cpus/cpu@003";
		cpu4 = "/cpus/cpu@100";
		cpu5 = "/cpus/cpu@101";
		cpu6 = "/cpus/cpu@102";
		cpu7 = "/cpus/cpu@103";
		STANDBY = "/cpus/idle-states/standby";
		MCDI_CPU = "/cpus/idle-states/mcdi-cpu";
		MCDI_CLUSTER = "/cpus/idle-states/mcdi-cluster";
		SODI = "/cpus/idle-states/sodi";
		SODI3 = "/cpus/idle-states/sodi3";
		DPIDLE = "/cpus/idle-states/dpidle";
		SUSPEND = "/cpus/idle-states/suspend";
		cpu_dbgapb = "/cpu_dbgapb@0d410000";
		msdc0 = "/msdc@11230000";
		msdc1 = "/msdc@11240000";
		reserved_memory = "/reserved-memory";
		gic = "/interrupt-controller@0c000000";
		sysirq = "/intpol-controller@0c530620";
		timer = "/timer";
		clk_null = "/clocks/clk_null";
		clk26m = "/clocks/clk26m";
		clk32k = "/clocks/clk32k";
		topckgen = "/topckgen@10000000";
		infracfg_ao = "/infracfg_ao@10001000";
		scpsys = "/scpsys@10001000";
		gpio_usage_mapping = "/gpio";
		gpio = "/gpio@10005000";
		syscfg_pctl_a = "/syscfg_pctl_a@10005000";
		syscfg_pctl_0 = "/syscfg_pctl_0@11f20000";
		syscfg_pctl_1 = "/syscfg_pctl_1@11e80000";
		syscfg_pctl_2 = "/syscfg_pctl_2@11e70000";
		syscfg_pctl_3 = "/syscfg_pctl_3@11e90000";
		syscfg_pctl_4 = "/syscfg_pctl_4@11d30000";
		syscfg_pctl_5 = "/syscfg_pctl_5@11d20000";
		syscfg_pctl_6 = "/syscfg_pctl_6@11c50000";
		syscfg_pctl_7 = "/syscfg_pctl_7@11f30000";
		pio = "/pinctrl@1000b000";
		msdc0_pins_default = "/pinctrl@1000b000/msdc0@default";
		msdc0_register_setting_default = "/pinctrl@1000b000/msdc0@register_default";
		msdc1_pins_default = "/pinctrl@1000b000/msdc1@default";
		msdc1_pins_sdr104 = "/pinctrl@1000b000/msdc1@sdr104";
		msdc1_pins_sdr50 = "/pinctrl@1000b000/msdc1@sdr50";
		msdc1_pins_ddr50 = "/pinctrl@1000b000/msdc1@ddr50";
		msdc1_register_setting_default = "/pinctrl@1000b000/msdc1@register_default";
		i2c0 = "/i2c@11007000";
		i2c1 = "/i2c@11011000";
		i2c2 = "/i2c@11009000";
		i2c3 = "/i2c@1100f000";
		i2c4 = "/i2c@11008000";
		i2c5 = "/i2c@11017000";
		i2c6 = "/i2c@11005000";
		i2c7 = "/i2c@1101a000";
		i2c8 = "/i2c@1101b000";
		i2c9 = "/i2c@11014000";
		i2c10 = "/i2c@11015000";
		i2c11 = "/i2c@11016000";
		apmixed = "/apmixed@1000c000";
		main_pmic = "/pwrap@1000d000/pmic_irq";
		keypad = "/kp@10010000";
		mrdump_ext_rst = "/mrdump_ext_rst";
		scp = "/scp@10500000";
		wifi = "/wifi@180f0000";
		mdcldma = "/mdcldma@10014000";
		auxadc = "/auxadc@11001000";
		apdma = "/dma-controller@11000780";
		apuart0 = "/serial@11002000";
		apuart1 = "/serial@11003000";
		apuart2 = "/serial@11004000";
		spi0 = "/spi@1100a000";
		spi1 = "/spi@11010000";
		spi2 = "/spi@11012000";
		spi3 = "/spi@11013000";
		spi4 = "/spi@11018000";
		spi5 = "/spi@11019000";
		consys = "/consys@18070000";
		irtx_pwm = "/irtx_pwm";
		usb0 = "/usb3@11200000";
		xhci0 = "/usb3_xhci@11200000";
		audio = "/audio@11220000";
		audgpio = "/mt_soc_dl1_pcm@11220000";
		ufshci = "/ufshci@11270000";
		mfgcfg = "/mfgcfg@13000000";
		mmsys_config = "/mmsys_config@14000000";
		touch_pad = "/touch_pad";
		touch = "/touch";
		hall_1 = "/hall_1";
		pah8011 = "/pah8011";
		lepton = "/lepton";
		remote = "/remote";
		accdet = "/accdet";
		bat_gm30 = "/battery";
		mdp_rdma0 = "/mdp_rdma0@14001000";
		mdp_rdma1 = "/mdp_rdma1@14002000";
		mdp_rsz0 = "/mdp_rsz0@14003000";
		mdp_rsz1 = "/mdp_rsz1@14004000";
		mdp_wrot0 = "/mdp_wrot0@14005000";
		mdp_wdma = "/mdp_wdma@14006000";
		mdp_tdshp = "/mdp_tdshp@14007000";
		mtkfb = "/mtkfb@0";
		dsi_te = "/dsi_te";
		mhl = "/mhl@0";
		disp_color0 = "/disp_color0@1400e000";
		disp_aal0 = "/disp_aal0@14010000";
		disp_mutex = "/disp_mutex@14016000";
		smi_larb0 = "/smi_larb0@14017000";
		mdp_aal = "/mdp_aal@1401b000";
		mdp_ccorr = "/mdp_ccorr@1401c000";
		vdec_gcon = "/vdec_gcon@16000000";
		smi_larb1 = "/smi_larb1@16010000";
		venc_gcon = "/venc_gcon@17000000";
		smi_larb4 = "/smi_larb4@17010000";
		venc = "/venc@17020000";
		imgsys = "/imgsys@15020000";
		smi_larb2 = "/smi_larb2@1502f000";
		smi_larb5 = "/smi_larb5@15021000";
		camsys = "/camsys@1a000000";
		ipu_conn = "/ipu_conn@19000000";
		ipu_adl = "/ipu_adl@19010000";
		ipu0 = "/ipu0@19180000";
		ipu1 = "/ipu1@19280000";
		smi_larb3 = "/smi_larb3@1a002000";
		smi_larb6 = "/smi_larb6@1a001000";
		kd_camera_hw1 = "/kd_camera_hw1@1a040000";
		flashlight_core = "/flashlight_core";
		flashlights_lm3642 = "/flashlights_lm3642";
		flashlights_ha7109 = "/flashlights_ha7109";
		flashlights_mt6370 = "/flashlights_mt6370";
		flashlights_rt4509 = "/flashlights_rt4509";
		flashlights_lm3643 = "/flashlights_lm3643";
		usbphy0 = "/usbphy";
		odm = "/odm";
		radio_md_cfg = "/radio_md_cfg";
		dynamic_options = "/dynamic_options";
		mt_charger = "/mt_charger";
		lk_charger = "/lk_charger";
		charger = "/charger";
		rt9465_slave_chr = "/rt9465_slave_chr";
		subpmic_pmu_eint = "/mt6370_pmu_eint";
		fingerprint = "/fingerprint";
		mcu = "/mcu";
		lepton_spi = "/lepton_spi";
		tcpc_pd = "/mt6370_pd_eint";
		rt5081_pmu_eint = "/rt5081_pmu_eint";
		rt5081_pd = "/rt5081_pd_eint";
		pmic_clock_buffer_ctrl = "/pmic_clock_buffer_ctrl";
		msdc1_ins = "/msdc1_ins";
		gyro = "/gyro";
		mse = "/mse";
		als = "/als";
		otg_iddig = "/otg_iddig";
		nfc = "/nfc";
		irq_nfc = "/irq_nfc";
		smart_pa = "/smart_pa";
		md1_sim1_hot_plug_eint = "/md1_sim1_hot_plug_eint";
		md1_sim2_hot_plug_eint = "/md1_sim2_hot_plug_eint";
		usb_c_pinctrl = "/usb_c_pinctrl";
		ssusb_ip_sleep = "/ssusb_ip_sleep";
		mt_pmic_vdram1_buck_reg = "/mt_pmic_regulator/buck_regulators/buck_vdram1";
		mt_pmic_vcore_buck_reg = "/mt_pmic_regulator/buck_regulators/buck_vcore";
		mt_pmic_vpa_buck_reg = "/mt_pmic_regulator/buck_regulators/buck_vpa";
		mt_pmic_vproc11_buck_reg = "/mt_pmic_regulator/buck_regulators/buck_vproc11";
		mt_pmic_vproc12_buck_reg = "/mt_pmic_regulator/buck_regulators/buck_vproc12";
		mt_pmic_vgpu_buck_reg = "/mt_pmic_regulator/buck_regulators/buck_vgpu";
		mt_pmic_vs2_buck_reg = "/mt_pmic_regulator/buck_regulators/buck_vs2";
		mt_pmic_vmodem_buck_reg = "/mt_pmic_regulator/buck_regulators/buck_vmodem";
		mt_pmic_vs1_buck_reg = "/mt_pmic_regulator/buck_regulators/buck_vs1";
		mt_pmic_vdram2_ldo_reg = "/mt_pmic_regulator/ldo_regulators/ldo_vdram2";
		mt_pmic_vsim1_ldo_reg = "/mt_pmic_regulator/ldo_regulators/ldo_vsim1";
		mt_pmic_vibr_ldo_reg = "/mt_pmic_regulator/ldo_regulators/ldo_vibr";
		mt_pmic_vrf12_ldo_reg = "/mt_pmic_regulator/ldo_regulators/ldo_vrf12";
		mt_pmic_vio18_ldo_reg = "/mt_pmic_regulator/ldo_regulators/ldo_vio18";
		mt_pmic_vusb_ldo_reg = "/mt_pmic_regulator/ldo_regulators/ldo_vusb";
		mt_pmic_vcamio_ldo_reg = "/mt_pmic_regulator/ldo_regulators/ldo_vcamio";
		mt_pmic_vcamd_ldo_reg = "/mt_pmic_regulator/ldo_regulators/ldo_vcamd";
		mt_pmic_vcn18_ldo_reg = "/mt_pmic_regulator/ldo_regulators/ldo_vcn18";
		mt_pmic_vfe28_ldo_reg = "/mt_pmic_regulator/ldo_regulators/ldo_vfe28";
		mt_pmic_vsram_proc11_ldo_reg = "/mt_pmic_regulator/ldo_regulators/ldo_vsram_proc11";
		mt_pmic_vcn28_ldo_reg = "/mt_pmic_regulator/ldo_regulators/ldo_vcn28";
		mt_pmic_vsram_others_ldo_reg = "/mt_pmic_regulator/ldo_regulators/ldo_vsram_others";
		mt_pmic_vsram_gpu_ldo_reg = "/mt_pmic_regulator/ldo_regulators/ldo_vsram_gpu";
		mt_pmic_vxo22_ldo_reg = "/mt_pmic_regulator/ldo_regulators/ldo_vxo22";
		mt_pmic_vefuse_ldo_reg = "/mt_pmic_regulator/ldo_regulators/ldo_vefuse";
		mt_pmic_vaux18_ldo_reg = "/mt_pmic_regulator/ldo_regulators/ldo_vaux18";
		mt_pmic_vmch_ldo_reg = "/mt_pmic_regulator/ldo_regulators/ldo_vmch";
		mt_pmic_vbif28_ldo_reg = "/mt_pmic_regulator/ldo_regulators/ldo_vbif28";
		mt_pmic_vsram_proc12_ldo_reg = "/mt_pmic_regulator/ldo_regulators/ldo_vsram_proc12";
		mt_pmic_vcama1_ldo_reg = "/mt_pmic_regulator/ldo_regulators/ldo_vcama1";
		mt_pmic_vemc_ldo_reg = "/mt_pmic_regulator/ldo_regulators/ldo_vemc";
		mt_pmic_vio28_ldo_reg = "/mt_pmic_regulator/ldo_regulators/ldo_vio28";
		mt_pmic_va12_ldo_reg = "/mt_pmic_regulator/ldo_regulators/ldo_va12";
		mt_pmic_vrf18_ldo_reg = "/mt_pmic_regulator/ldo_regulators/ldo_vrf18";
		mt_pmic_vcn33_bt_ldo_reg = "/mt_pmic_regulator/ldo_regulators/ldo_vcn33_bt";
		mt_pmic_vcn33_wifi_ldo_reg = "/mt_pmic_regulator/ldo_regulators/ldo_vcn33_wifi";
		mt_pmic_vcama2_ldo_reg = "/mt_pmic_regulator/ldo_regulators/ldo_vcama2";
		mt_pmic_vmc_ldo_reg = "/mt_pmic_regulator/ldo_regulators/ldo_vmc";
		mt_pmic_vldo28_ldo_reg = "/mt_pmic_regulator/ldo_regulators/ldo_vldo28";
		mt_pmic_vaud28_ldo_reg = "/mt_pmic_regulator/ldo_regulators/ldo_vaud28";
		mt_pmic_vsim2_ldo_reg = "/mt_pmic_regulator/ldo_regulators/ldo_vsim2";
		mt_pmic_va09_ldo_reg = "/mt_pmic_regulator/ldo_regulators/ldo_va09";
		mt6370_pmu = "/mt6370_pmu_dts";
		mt6370_typec = "/type_c_port0";
	};
};
